/dts-v1/;

/ {
	model = "mt6739";
	compatible = "mediatek,mt6739";
	interrupt-parent = <0x01>;
	#address-cells = <0x02>;
	#size-cells = <0x02>;
/*
	aliases {
	display0 = &framebuffer0;
	};
*/

	chosen {
		bootargs = "console=tty0 console=ttyMT0,921600n1 initrd=0x44000000,\
	0x1000000 loglevel=8 clk_ignore_unused pd_ignore_unused earlyprintk";
		linux,phandle = <0x38>;
		phandle = <0x38>;
	};



	pmu {
		compatible = "arm,cortex-a7-pmu";
		interrupt-parent = <0x02>;
		interrupts = <0x01 0x07 0x08>;
	};

	cpus {
		#address-cells = <0x01>;
		#size-cells = <0x00>;

		cpu@0 {
			device_type = "cpu";
			compatible = "arm,cortex-a53";
			reg = <0x00>;
			enable-method = "psci";
			cpu-release-addr = <0x00 0x40000200>;
			clock-frequency = <0x77359400>;
			cpu-idle-states = <0x03 0x04 0x05 0x06 0x07 0x08 0x09>;
			linux,phandle = <0x0a>;
			phandle = <0x0a>;
		};

		cpu@001 {
			device_type = "cpu";
			compatible = "arm,cortex-a53";
			reg = <0x01>;
			enable-method = "psci";
			cpu-release-addr = <0x00 0x40000200>;
			clock-frequency = <0x61a1e580>;
			cpu-idle-states = <0x03 0x04 0x05 0x06 0x07 0x08 0x09>;
			linux,phandle = <0x0b>;
			phandle = <0x0b>;
		};

		cpu@002 {
			device_type = "cpu";
			compatible = "arm,cortex-a53";
			reg = <0x02>;
			enable-method = "psci";
			cpu-release-addr = <0x00 0x40000200>;
			clock-frequency = <0x61a1e580>;
			cpu-idle-states = <0x03 0x04 0x05 0x06 0x07 0x08 0x09>;
			linux,phandle = <0x0c>;
			phandle = <0x0c>;
		};

		cpu@003 {
			device_type = "cpu";
			compatible = "arm,cortex-a53";
			reg = <0x03>;
			enable-method = "psci";
			cpu-release-addr = <0x00 0x40000200>;
			clock-frequency = <0x61a1e580>;
			cpu-idle-states = <0x03 0x04 0x05 0x06 0x07 0x08 0x09>;
			linux,phandle = <0x0d>;
			phandle = <0x0d>;
		};

		cpu-map {

			cluster0 {

				core0 {
					cpu = <0x0a>;
				};

				core1 {
					cpu = <0x0b>;
				};

				core2 {
					cpu = <0x0c>;
				};

				core3 {
					cpu = <0x0d>;
				};
			};
		};

		idle-states {
			entry-method = "arm,psci";

			standby {
				compatible = "arm,idle-state";
				arm,psci-suspend-param = <0x01>;
				entry-latency-us = <0x258>;
				exit-latency-us = <0x258>;
				min-residency-us = <0x4b0>;
				linux,phandle = <0x03>;
				phandle = <0x03>;
			};

			mcdi-cpu {
				compatible = "arm,idle-state";
				arm,psci-suspend-param = <0x10001>;
				entry-latency-us = <0x258>;
				exit-latency-us = <0x258>;
				min-residency-us = <0x4b0>;
				linux,phandle = <0x04>;
				phandle = <0x04>;
			};

			mcdi-cluster {
				compatible = "arm,idle-state";
				arm,psci-suspend-param = <0x1010001>;
				entry-latency-us = <0x258>;
				exit-latency-us = <0x258>;
				min-residency-us = <0x4b0>;
				linux,phandle = <0x05>;
				phandle = <0x05>;
			};

			sodi {
				compatible = "arm,idle-state";
				arm,psci-suspend-param = <0x1010002>;
				entry-latency-us = <0x320>;
				exit-latency-us = <0x3e8>;
				min-residency-us = <0x7d0>;
				linux,phandle = <0x06>;
				phandle = <0x06>;
			};

			sodi3 {
				compatible = "arm,idle-state";
				arm,psci-suspend-param = <0x1010003>;
				entry-latency-us = <0x320>;
				exit-latency-us = <0x3e8>;
				min-residency-us = <0x7d0>;
				linux,phandle = <0x07>;
				phandle = <0x07>;
			};

			dpidle {
				compatible = "arm,idle-state";
				arm,psci-suspend-param = <0x1010004>;
				entry-latency-us = <0x320>;
				exit-latency-us = <0x3e8>;
				min-residency-us = <0x7d0>;
				linux,phandle = <0x08>;
				phandle = <0x08>;
			};

			suspend {
				compatible = "arm,idle-state";
				arm,psci-suspend-param = <0x1010005>;
				entry-latency-us = <0x320>;
				exit-latency-us = <0x3e8>;
				min-residency-us = <0x7d0>;
				linux,phandle = <0x09>;
				phandle = <0x09>;
			};
		};
	};

	mobicore {
		compatible = "trustonic,mobicore";
		interrupts = <0x00 0x6e 0x01>;
	};

	tkcore {
		compatible = "trustkernel,tkcore";
		interrupts = <0x00 0x6e 0x00>;
	};

	psci {
		compatible = "arm,psci-0.2";
		method = "smc";
	};

	memory {
		device_type = "memory";
		reg = <0x00 0x40000000 0x00 0x20000000>;
	};

	cpu_dbgapb {
		compatible = "mediatek,hw_dbg";
		num = <0x04>;
		reg = <0x00 0xd410000 0x00 0x1000 0x00 0xd510000 0x00 0x1000 0x00 0xd610000 0x00 0x1000 0x00 0xd710000 0x00 0x1000>;
		linux,phandle = <0x39>;
		phandle = <0x39>;
	};

	atf_logger {
		compatible = "mediatek,atf_logger";
		interrupts = <0x00 0xf1 0x01>;
	};

	amms_control {
		compatible = "mediatek,amms";
		interrupts = <0x00 0x7b 0x01>;
	};

	utos {
		compatible = "microtrust,utos";
		interrupts = <0x00 0x83 0x01 0x00 0x84 0x01>;
	};

	reserved-memory {
		#address-cells = <0x02>;
		#size-cells = <0x02>;
		ranges;
		linux,phandle = <0x3a>;
		phandle = <0x3a>;


		pstore-reserved-memory@44410000 {
			compatible = "mediatek,pstore";
			reg = <0x00 0x44410000 0x00 0xe0000>;
		};

		ram_console-reserved-memory@44400000 {
			compatible = "mediatek,ram_console";
			reg = <0x00 0x44400000 0x00 0x10000>;
		};

		minirdump-reserved-memory@444f0000 {
			compatible = "mediatek,minirdump";
			reg = <0x00 0x444f0000 0x00 0x10000>;
		};

		consys-reserve-memory {
			compatible = "mediatek,consys-reserve-memory";
			#address-cells = <0x02>;
			#size-cells = <0x02>;
			no-map;
			size = <0x00 0x200000>;
			alignment = <0x00 0x200000>;
			alloc-ranges = <0x00 0x40000000 0x00 0x38000000>;
		};

	};

	interrupt-controller@0c000000 {
		compatible = "arm,gic-v3";
		#interrupt-cells = <0x03>;
		#address-cells = <0x02>;
		#size-cells = <0x02>;
		#redistributor-regions = <0x01>;
		interrupt-parent = <0x02>;
		interrupt-controller;
		reg = <0x00 0xc000000 0x00 0x40000 0x00 0xc080000 0x00 0x200000 0x00 0x10200620 0x00 0x1000>;
		interrupts = <0x01 0x09 0x04>;
		mediatek,reg_len_pol0 = <0x08>;
		linux,phandle = <0x02>;
		phandle = <0x02>;
	};

	intpol-controller@0x10200620 {
		compatible = "mediatek,mt6739-sysirq", "mediatek,mt6577-sysirq";
		interrupt-controller;
		#interrupt-cells = <0x03>;
		interrupt-parent = <0x02>;
		reg = <0x00 0x10200620 0x00 0x20>;
		linux,phandle = <0x01>;
		phandle = <0x01>;
	};

	chipid@08000000 {
		compatible = "mediatek,chipid";
		reg = <0x00 0x8000000 0x00 0x04 0x00 0x8000004 0x00 0x04 0x00 0x8000008 0x00 0x04 0x00 0x800000c 0x00 0x04>;
	};

	timer {
		compatible = "arm,armv8-timer";
		interrupt-parent = <0x02>;
		interrupts = <0x01 0x0d 0x08 0x01 0x0e 0x08 0x01 0x0b 0x08 0x01 0x0a 0x08>;
		clock-frequency = <0xc65d40>;
	};

	clk26m {
		compatible = "fixed-clock";
		#clock-cells = <0x00>;
		clock-frequency = <0x18cba80>;
		linux,phandle = <0x25>;
		phandle = <0x25>;
	};

	topckgen@10000000 {
		compatible = "mediatek,topckgen", "syscon";
		reg = <0x00 0x10000000 0x00 0x1000 0x00 0x1000c000 0x00 0x1000>;
		#clock-cells = <0x01>;
		linux,phandle = <0x24>;
		phandle = <0x24>;
	};

	infracfg_ao@10001000 {
		compatible = "mediatek,infracfg_ao", "syscon";
		reg = <0x00 0x10001000 0x00 0x1000>;
		interrupts = <0x00 0x93 0x01>;
		#clock-cells = <0x01>;
		linux,phandle = <0x19>;
		phandle = <0x19>;
	};

	scpsys@10001000 {
		compatible = "mediatek,scpsys";
		reg = <0x00 0x10001000 0x00 0x1000 0x00 0x10006000 0x00 0x1000 0x00 0x1020e000 0x00 0x1000>;
		#clock-cells = <0x01>;
		linux,phandle = <0x1a>;
		phandle = <0x1a>;
	};

	clk32k {
		compatible = "fixed-clock";
		#clock-cells = <0x00>;
		clock-frequency = <0x7d00>;
		linux,phandle = <0x18>;
		phandle = <0x18>;
	};

	io_cfg_lt@10002000 {
		compatible = "mediatek,io_cfg_lt";
		reg = <0x00 0x10002000 0x00 0x200>;
	};

	syscfg_pctl_lt@10002000 {
		compatible = "mediatek,pctl-lt-syscfg", "syscon";
		reg = <0x00 0x10002000 0x00 0x1000>;
		linux,phandle = <0x0f>;
		phandle = <0x0f>;
	};

	io_cfg_lm@10002200 {
		compatible = "mediatek,io_cfg_lm";
		reg = <0x00 0x10002200 0x00 0x200>;
	};

	syscfg_pctl_lm@10002200 {
		compatible = "mediatek,pctl-lm-syscfg", "syscon";
		reg = <0x00 0x10002200 0x00 0x1000>;
		linux,phandle = <0x10>;
		phandle = <0x10>;
	};

	io_cfg_lb@10002400 {
		compatible = "mediatek,io_cfg_lb";
		reg = <0x00 0x10002400 0x00 0x200>;
	};

	syscfg_pctl_lb@10002400 {
		compatible = "mediatek,pctl-lb-syscfg", "syscon";
		reg = <0x00 0x10002400 0x00 0x1000>;
		linux,phandle = <0x11>;
		phandle = <0x11>;
	};

	io_cfg_bl@10002600 {
		compatible = "mediatek,io_cfg_bl";
		reg = <0x00 0x10002600 0x00 0x200>;
	};

	syscfg_pctl_bl@10002600 {
		compatible = "mediatek,pctl-bl-syscfg", "syscon";
		reg = <0x00 0x10002600 0x00 0x1000>;
		linux,phandle = <0x12>;
		phandle = <0x12>;
	};

	io_cfg_bm@10002800 {
		compatible = "mediatek,io_cfg_bm";
		reg = <0x00 0x10002800 0x00 0x200>;
	};

	syscfg_pctl_bm@10002800 {
		compatible = "mediatek,pctl-bm-syscfg", "syscon";
		reg = <0x00 0x10002800 0x00 0x1000>;
		linux,phandle = <0x13>;
		phandle = <0x13>;
	};

	io_cfg_rb@10002a00 {
		compatible = "mediatek,io_cfg_rb";
		reg = <0x00 0x10002a00 0x00 0x200>;
	};

	syscfg_pctl_rb@10002a00 {
		compatible = "mediatek,pctl-rb-syscfg", "syscon";
		reg = <0x00 0x10002a00 0x00 0x1000>;
		linux,phandle = <0x14>;
		phandle = <0x14>;
	};

	io_cfg_rt@10002c00 {
		compatible = "mediatek,io_cfg_rt";
		reg = <0x00 0x10002c00 0x00 0x200>;
	};

	syscfg_pctl_bl@10002c00 {
		compatible = "mediatek,pctl-rt-syscfg", "syscon";
		reg = <0x00 0x10002c00 0x00 0x1000>;
		linux,phandle = <0x15>;
		phandle = <0x15>;
	};

	pericfg@10003000 {
		compatible = "mediatek,pericfg";
		reg = <0x00 0x10003000 0x00 0x1000>;
	};

	efuse_dbg@10004000 {
		compatible = "mediatek,efuse_dbg";
		reg = <0x00 0x10004000 0x00 0x1000>;
	};

	gpio {
		compatible = "mediatek,gpio_usage_mapping";
		linux,phandle = <0x3b>;
		phandle = <0x3b>;
	};

	gpio@10005000 {
		compatible = "mediatek,gpio";
		reg = <0x00 0x10005000 0x00 0x1000>;
		linux,phandle = <0x3c>;
		phandle = <0x3c>;
	};

	syscfg_pctl_a@10005000 {
		compatible = "mediatek,pctl-a-syscfg", "syscon";
		reg = <0x00 0x10005000 0x00 0x1000>;
		linux,phandle = <0x0e>;
		phandle = <0x0e>;
	};

	accdet {
		compatible = "mediatek,pmic-accdet";
		linux,phandle = <0x3d>;
		phandle = <0x3d>;
	};

	pinctrl@1000b000 {
		compatible = "mediatek,pinctrl";
		reg = <0x00 0x1000b000 0x00 0x1000>;
		mediatek,pctl-regmap = <0x0e 0x0f 0x10 0x11 0x12 0x13 0x14 0x15>;
		pins-are-numbered;
		gpio-controller;
		#gpio-cells = <0x02>;
		interrupt-controller;
		#interrupt-cells = <0x04>;
		interrupts = <0x00 0xa7 0x04>;
		linux,phandle = <0x2e>;
		phandle = <0x2e>;
	};

	sleep@10006000 {
		compatible = "mediatek,sleep";
		reg = <0x00 0x10006000 0x00 0x1000>;
		interrupts = <0x00 0xb1 0x08>;
		wakeup-source = <0x16 0x00 0x04 0x17 0x03 0x2000000>;
	};

	toprgu@10007000 {
		compatible = "mediatek,toprgu";
		reg = <0x00 0x10007000 0x00 0x1000>;
		interrupts = <0x00 0x8b 0x00>;
	};

	apxgpt@10008000 {
		compatible = "mediatek,apxgpt";
		reg = <0x00 0x10008000 0x00 0x1000>;
		interrupts = <0x00 0xa6 0x08>;
		clocks = <0x18>;
	};

	hacc@1000a000 {
		compatible = "mediatek,hacc";
		reg = <0x00 0x1000a000 0x00 0x1000>;
		interrupts = <0x00 0xb5 0x08>;
	};

	apmixed@1000c000 {
		compatible = "mediatek,apmixed", "mediatek,apmixedsys", "syscon";
		reg = <0x00 0x1000c000 0x00 0x1000>;
		#clock-cells = <0x01>;
		linux,phandle = <0x32>;
		phandle = <0x32>;
	};

	fhctl@1000ce00 {
		compatible = "mediatek,fhctl";
		reg = <0x00 0x1000ce00 0x00 0x100>;
	};

	pwrap@1000d000 {
		compatible = "mediatek,pwrap";
		reg = <0x00 0x1000d000 0x00 0x1000>;
		interrupts = <0x00 0xaf 0x04>;

		pmic_irq {
			compatible = "mediatek,pmic-eint";
			interrupt-controller;
			linux,phandle = <0x3e>;
			phandle = <0x3e>;
		};
	};

	sleep_reg_md@1000f000 {
		compatible = "mediatek,sleep_reg_md";
		reg = <0x00 0x1000f000 0x00 0x1000>;
	};

	kp@10010000 {
		compatible = "mediatek,kp";
		reg = <0x00 0x10010000 0x00 0x1000>;
		interrupts = <0x00 0xb0 0x02>;
		linux,phandle = <0x16>;
		phandle = <0x16>;
	};

	topmisc@10011000 {
		compatible = "mediatek,topmisc";
		reg = <0x00 0x10011000 0x00 0x1000>;
	};

	dvfsrc_top@10012000 {
		compatible = "mediatek,dvfsrc_top";
		reg = <0x00 0x10012000 0x00 0x1000>;
	};

	mbist_ao@10013000 {
		compatible = "mediatek,mbist_ao";
		reg = <0x00 0x10013000 0x00 0x1000>;
	};

	apcldmain_ao@10014000 {
		compatible = "mediatek,apcldmain_ao";
		reg = <0x00 0x10014000 0x00 0x400>;
	};

	apcldmaout_ao@10014400 {
		compatible = "mediatek,apcldmaout_ao";
		reg = <0x00 0x10014400 0x00 0x400>;
	};

	apcldmamisc_ao@10014800 {
		compatible = "mediatek,apcldmamisc_ao";
		reg = <0x00 0x10014800 0x00 0x400>;
	};

	apcldmamisc_ao@10014c00 {
		compatible = "mediatek,apcldmamisc_ao";
		reg = <0x00 0x10014c00 0x00 0x400>;
	};

	aes_top0@10016000 {
		compatible = "mediatek,aes_top0";
		reg = <0x00 0x10016000 0x00 0x1000>;
	};

	sys_timer@10017000 {
		compatible = "mediatek,sys_timer";
		reg = <0x00 0x10017000 0x00 0x1000 0x00 0x10ffec 0x00 0x14>;
		interrupts = <0x00 0xba 0x04>;
		mediatek,sysram-size = <0x14>;
	};

	modem_temp_share@10018000 {
		compatible = "mediatek,modem_temp_share";
		reg = <0x00 0x10018000 0x00 0x1000>;
	};

	security_ao@1001a000 {
		compatible = "mediatek,security_ao";
		reg = <0x00 0x1001a000 0x00 0x1000>;
	};

	topckgen_ao@1001b000 {
		compatible = "mediatek,topckgen_ao";
		reg = <0x00 0x1001b000 0x00 0x1000>;
	};

	dramc0@1001d000 {
		compatible = "mediatek,dramc0";
		reg = <0x00 0x1001d000 0x00 0x1000>;
	};

	dramc@1001d000 {
		compatible = "mediatek,dramc";
		reg = <0x00 0x1001d000 0x00 0x1000 0x00 0x1021d000 0x00 0x1000 0x00 0x1001e000 0x00 0x1000>;
	};

	ddrphy@1001e000 {
		compatible = "mediatek,ddrphy";
		reg = <0x00 0x1001e000 0x00 0x1000>;
	};

	iocfg_0@10002000 {
		compatible = "mediatek,iocfg_0";
		reg = <0x00 0x10002000 0x00 0x200>;
	};

	iocfg_1@10002200 {
		compatible = "mediatek,iocfg_1";
		reg = <0x00 0x10002200 0x00 0x200>;
	};

	iocfg_2@10002400 {
		compatible = "mediatek,iocfg_2";
		reg = <0x00 0x10002400 0x00 0x200>;
	};

	iocfg_3@10002600 {
		compatible = "mediatek,iocfg_3";
		reg = <0x00 0x10002600 0x00 0x200>;
	};

	iocfg_4@10002800 {
		compatible = "mediatek,iocfg_4";
		reg = <0x00 0x10002800 0x00 0x200>;
	};

	iocfg_5@10002a00 {
		compatible = "mediatek,iocfg_5";
		reg = <0x00 0x10002a00 0x00 0x200>;
	};

	mdcldmain_ao@10015000 {
		compatible = "mediatek,mdcldmain_ao";
		reg = <0x00 0x10015000 0x00 0x400>;
	};

	mdcldmaout_ao@10015400 {
		compatible = "mediatek,mdcldmaout_ao";
		reg = <0x00 0x10015400 0x00 0x400>;
	};

	mdcldmamisc_ao@10015800 {
		compatible = "mediatek,mdcldmamisc_ao";
		reg = <0x00 0x10015800 0x00 0x400>;
	};

	sys_cirq@10204000 {
		compatible = "mediatek,sys_cirq";
		reg = <0x00 0x10204000 0x00 0x1000>;
		mediatek,cirq_num = <0xa8>;
		mediatek,spi_start_offset = <0x48>;
		interrupts = <0x00 0xf0 0x08>;
	};

	mcucfg@10200000 {
		compatible = "mediatek,mcucfg";
		reg = <0x00 0x10200000 0x00 0x1000>;
		interrupts = <0x00 0x00 0x08>;
	};

	m4u@10205000 {
		cell-index = <0x00>;
		compatible = "mediatek,m4u";
		reg = <0x00 0x10205000 0x00 0x1000>;
		interrupts = <0x00 0x9e 0x08>;
	};

	devapc@10207000 {
		compatible = "mediatek,devapc";
		reg = <0x00 0x10207000 0x00 0x1000>;
		interrupts = <0x00 0x8e 0x08>;
		clocks = <0x19 0x2a>;
		clock-names = "devapc-infra-clock";
	};

	bus_dbg@10208000 {
		compatible = "mediatek,bus_dbg-v2";
		reg = <0x00 0x10208000 0x00 0x1000 0x00 0x10001000 0x00 0x1000>;
		mediatek,bus_dbg_con_offset = <0x2fc>;
		interrupts = <0x00 0x8d 0x08>;
	};

	ap_ccif0@10209000 {
		compatible = "mediatek,ap_ccif0";
		reg = <0x00 0x10209000 0x00 0x1000>;
		interrupts = <0x00 0x94 0x08>;
	};

	md_ccif0@1020a000 {
		compatible = "mediatek,md_ccif0";
		reg = <0x00 0x1020a000 0x00 0x1000>;
	};

	ap_ccif1@1020b000 {
		compatible = "mediatek,ap_ccif1";
		reg = <0x00 0x1020b000 0x00 0x1000>;
		interrupts = <0x00 0x96 0x08>;
	};

	md_ccif1@1020c000 {
		compatible = "mediatek,md_ccif1";
		reg = <0x00 0x1020c000 0x00 0x1000>;
	};

	infra_mbist@1020d000 {
		compatible = "mediatek,infra_mbist";
		reg = <0x00 0x1020d000 0x00 0x1000>;
	};

	infracfg@1020e000 {
		compatible = "mediatek,infracfg";
		reg = <0x00 0x1020e000 0x00 0x1000>;
	};

	trng@1020f000 {
		compatible = "mediatek,trng";
		reg = <0x00 0x1020f000 0x00 0x1000>;
		interrupts = <0x00 0xa1 0x08>;
	};

	dxcc_sec@10210000 {
		compatible = "mediatek,dxcc_sec";
		reg = <0x00 0x10210000 0x00 0x1000>;
		interrupts = <0x00 0xa2 0x04>;
	};

	md2md_md1_ccif0@10211000 {
		compatible = "mediatek,md2md_md1_ccif0";
		reg = <0x00 0x10211000 0x00 0x1000>;
	};

	cq_dma@10212000 {
		compatible = "mediatek,mt-cqdma-v1";
		reg = <0x00 0x10212080 0x00 0x80>;
		interrupts = <0x00 0x72 0x08>;
		nr_channel = <0x01>;
		keep_clock_ao = "yes";
		clocks = <0x19 0x44>;
		clock-names = "cqdma";
	};

	md2md_md2_ccif0@10213000 {
		compatible = "mediatek,md2md_md2_ccif0";
		reg = <0x00 0x10213000 0x00 0x1000>;
	};

	sramrom@10214000 {
		compatible = "mediatek,sramrom";
		reg = <0x00 0x10214000 0x00 0x1000>;
	};

	mipi_tx0@11c80000 {
		compatible = "mediatek,mipi_tx0";
		reg = <0x00 0x11c80000 0x00 0x1000>;
	};

	mcdi@10216000 {
		compatible = "mediatek,mt6739-mcdi";
		reg = <0x00 0x10fc00 0x00 0x400 0x00 0x10216000 0x00 0x1000 0x00 0x10217000 0x00 0x2000>;
	};

	emi@10219000 {
		compatible = "mediatek,emi";
		reg = <0x00 0x10219000 0x00 0x1000 0x00 0x1021a000 0x00 0x1000 0x00 0x10226000 0x00 0x1000>;
		interrupts = <0x00 0x90 0x08 0x00 0x91 0x04 0x00 0x98 0x04>;
	};

	apcldmain@1021b000 {
		compatible = "mediatek,apcldmain";
		reg = <0x00 0x1021b000 0x00 0x00>;
	};

	apcldmain@1021b100 {
		compatible = "mediatek,apcldmain";
		reg = <0x00 0x1021b100 0x00 0x00>;
	};

	apcldmaout@1021b400 {
		compatible = "mediatek,apcldmaout";
		reg = <0x00 0x1021b400 0x00 0x00>;
	};

	apcldmaout@1021b500 {
		compatible = "mediatek,apcldmaout";
		reg = <0x00 0x1021b500 0x00 0x00>;
	};

	apcldmamisc@1021b800 {
		compatible = "mediatek,apcldmamisc";
		reg = <0x00 0x1021b800 0x00 0x00>;
		interrupts = <0x00 0xa5 0x04>;
	};

	apcldmamisc@1021b900 {
		compatible = "mediatek,apcldmamisc";
		reg = <0x00 0x1021b900 0x00 0x400>;
	};

	mdcldmain@1021c000 {
		compatible = "mediatek,mdcldmain";
		reg = <0x00 0x1021c000 0x00 0x400>;
	};

	mdcldmaout@1021c400 {
		compatible = "mediatek,mdcldmaout";
		reg = <0x00 0x1021c400 0x00 0x400>;
	};

	mdcldmamisc@1021c000 {
		compatible = "mediatek,mdcldmamisc";
		reg = <0x00 0x1021c000 0x00 0x00>;
	};

	mdcldmamisc@1021c900 {
		compatible = "mediatek,mdcldmamisc";
		reg = <0x00 0x1021c900 0x00 0x400>;
	};

	mdcldma@10014000 {
		compatible = "mediatek,mdcldma";
		reg = <0x00 0x10014000 0x00 0x1000 0x00 0x1021b000 0x00 0x1000 0x00 0x10209000 0x00 0x1000 0x00 0x1020a000 0x00 0x1000>;
		interrupts = <0x00 0xa5 0x04 0x00 0x94 0x08 0x00 0x95 0x08 0x00 0xe3 0x02>;
		mediatek,md_id = <0x00>;
		mediatek,cldma_capability = <0x06>;
		clocks = <0x1a 0x02 0x19 0x34 0x19 0x2b 0x19 0x2e 0x19 0x24 0x19 0x25>;
		clock-names = "scp-sys-md1-main", "infra-cldma-bclk", "infra-ccif-ap", "infra-ccif-md", "infra-ccif1-ap", "infra-ccif1-md";
		linux,phandle = <0x17>;
		phandle = <0x17>;
	};

	dramc_nao@1021d000 {
		compatible = "mediatek,dramc_nao";
		reg = <0x00 0x1021d000 0x00 0x1000>;
	};

	bpi_bsi_slv0@1021e000 {
		compatible = "mediatek,bpi_bsi_slv0";
		reg = <0x00 0x1021e000 0x00 0x1000>;
	};

	bpi_bsi_slv1@1021f000 {
		compatible = "mediatek,bpi_bsi_slv1";
		reg = <0x00 0x1021f000 0x00 0x6000>;
	};

	bpi_bsi_slv2@10225000 {
		compatible = "mediatek,bpi_bsi_slv2";
		reg = <0x00 0x10225000 0x00 0x1000>;
	};

	dvfsp@10227000 {
		compatible = "mediatek,dvfsp";
		reg = <0x00 0x10227000 0x00 0x1000>;
		interrupts = <0x00 0xa3 0x08>;
	};

	gce@10228000 {
		compatible = "mediatek,gce";
		reg = <0x00 0x10228000 0x00 0x4000>;
		interrupts = <0x00 0x9a 0x08 0x00 0x9b 0x08>;
		g3d_config_base = <0x13000000 0x00 0xffff0000>;
		mmsys_config_base = <0x14000000 0x01 0xffff0000>;
		disp_dither_base = <0x14010000 0x02 0xffff0000>;
		mm_na_base = <0x14020000 0x03 0xffff0000>;
		imgsys_base = <0x15020000 0x04 0xffff0000>;
		vdec_gcon_base = <0x18800000 0x05 0xffff0000>;
		venc_gcon_base = <0x18810000 0x06 0xffff0000>;
		conn_peri_base = <0x18820000 0x07 0xffff0000>;
		topckgen_base = <0x18830000 0x08 0xffff0000>;
		kp_base = <0x18840000 0x09 0xffff0000>;
		scp_sram_base = <0x10000000 0x0a 0xffff0000>;
		infra_na3_base = <0x10010000 0x0b 0xffff0000>;
		infra_na4_base = <0x10020000 0x0c 0xffff0000>;
		scp_base = <0x10030000 0x0d 0xffff0000>;
		mcucfg_base = <0x10040000 0x0e 0xffff0000>;
		gcpu_base = <0x10050000 0x0f 0xffff0000>;
		usb0_base = <0x10200000 0x10 0xffff0000>;
		usb_sif_base = <0x10280000 0x11 0xffff0000>;
		audio_base = <0x17000000 0x12 0xffff0000>;
		vdec_base = <0x17010000 0x13 0xffff0000>;
		msdc2_base = <0x17020000 0x14 0xffff0000>;
		vdec1_base = <0x17030000 0x15 0xffff0000>;
		msdc3_base = <0x18000000 0x16 0xffff0000>;
		ap_dma_base = <0x18010000 0x17 0xffff0000>;
		gce_base = <0x18020000 0x18 0xffff0000>;
		vdec2_base = <0x18040000 0x19 0xffff0000>;
		vdec3_base = <0x18050000 0x1a 0xffff0000>;
		camsys_base = <0x18080000 0x1b 0xffff0000>;
		camsys1_base = <0x180a0000 0x1c 0xffff0000>;
		camsys2_base = <0x180b0000 0x1d 0xffff0000>;
		pwm_sw_base = <0x11000000 0x63 0xffff0000>;
		mdp_rdma0_sof = <0x00>;
		mdp_rsz0_sof = <0x01>;
		mdp_rsz1_sof = <0x02>;
		mdp_wdma_sof = <0x03>;
		mdp_wrot0_sof = <0x04>;
		mdp_tdshp_sof = <0x05>;
		disp_ovl0_sof = <0x06>;
		disp_rdma0_sof = <0x07>;
		disp_wdma0_sof = <0x08>;
		disp_color0_sof = <0x09>;
		disp_ccorr0_sof = <0x0a>;
		disp_aal0_sof = <0x0b>;
		disp_gamma0_sof = <0x0c>;
		disp_dither0_sof = <0x0d>;
		disp_dsi0_sof = <0x0e>;
		disp_dbi0_sof = <0x0f>;
		disp_pwm0_sof = <0x10>;
		disp_rdma0_frame_done = <0x11>;
		mdp_rdma0_frame_done = <0x12>;
		mdp_rsz0_frame_done = <0x13>;
		mdp_rsz1_frame_done = <0x14>;
		mdp_tdshp_frame_done = <0x15>;
		mdp_wrot0_write_frame_done = <0x16>;
		mdp_wdma_frame_done = <0x17>;
		disp_ovl0_frame_done = <0x18>;
		disp_wdma0_frame_done = <0x19>;
		disp_color0_frame_done = <0x1a>;
		disp_ccorr0_frame_done = <0x1b>;
		disp_aal0_frame_done = <0x1c>;
		disp_gamma0_frame_done = <0x1d>;
		disp_dither0_frame_done = <0x1e>;
		disp_dsi0_frame_done = <0x1f>;
		disp_dbi0_frame_done = <0x20>;
		stream_done_0 = <0x82>;
		stream_done_1 = <0x83>;
		stream_done_2 = <0x84>;
		stream_done_3 = <0x85>;
		stream_done_4 = <0x86>;
		stream_done_5 = <0x87>;
		stream_done_6 = <0x88>;
		stream_done_7 = <0x89>;
		stream_done_8 = <0x8a>;
		stream_done_9 = <0x8b>;
		buf_underrun_event_0 = <0x8c>;
		buf_underrun_event_1 = <0x8d>;
		dsi0_te_event = <0x8e>;
		dsi0_irq_event = <0x8f>;
		dsi0_done_event = <0x90>;
		disp_wdma0_rst_done = <0x94>;
		mdp_wdma_rst_done = <0x95>;
		mdp_wrot0_rst_done = <0x96>;
		mdp_rdma0_rst_done = <0x98>;
		disp_ovl0_frame_rst_done_pusle = <0x99>;
		isp_frame_done_p2_2 = <0x101>;
		isp_frame_done_p2_1 = <0x102>;
		isp_frame_done_p2_0 = <0x103>;
		isp_frame_done_p1_1 = <0x104>;
		isp_frame_done_p1_0 = <0x105>;
		camsv_2_pass1_done = <0x106>;
		camsv_1_pass1_done = <0x107>;
		seninf_cam1_2_3_fifo_full = <0x108>;
		seninf_cam0_fifo_full = <0x109>;
		venc_done = <0x121>;
		jpgenc_done = <0x122>;
		jpgdec_done = <0x123>;
		venc_mb_done = <0x124>;
		venc_128byte_cnt_done = <0x125>;
		max_prefetch_cnt = <0x01>;
		prefetch_size = <0x60>;
		sram_size_cpr_64 = <0x40>;
		mmsys_config = <0x1b>;
		mdp_rdma0 = <0x1c>;
		mdp_rsz0 = <0x1d>;
		mdp_rsz1 = <0x1e>;
		mdp_wdma0 = <0x1f>;
		mdp_wrot0 = <0x20>;
		mdp_tdshp0 = <0x21>;
		mm_mutex = <0x22>;
		disp_ovl0 = <0x23>;
		sram_share_cnt = <0x01>;
		sram_share_engine = <0x08>;
		sram_share_event = <0x1e0>;
		clocks = <0x19 0x07 0x19 0x18>;
		clock-names = "GCE", "GCE_TIMER";
	};

	dramc_ch0_top0@10228000 {
		compatible = "mediatek,dramc_ch0_top0";
		reg = <0x00 0x10228000 0x00 0x2000>;
	};

	dramc_ch0_top1@1022a000 {
		compatible = "mediatek,dramc_ch0_top1";
		reg = <0x00 0x1022a000 0x00 0x2000>;
	};

	dramc_ch0_top2@1022c000 {
		compatible = "mediatek,dramc_ch0_top2";
		reg = <0x00 0x1022c000 0x00 0x1000>;
	};

	dramc_ch0_top3@1022d000 {
		compatible = "mediatek,dramc_ch0_top3";
		reg = <0x00 0x1022d000 0x00 0x1000>;
	};

	dramc_ch0_rsv@1022e000 {
		compatible = "mediatek,dramc_ch0_rsv";
		reg = <0x00 0x1022e000 0x00 0x2000>;
	};

	dramc_ch1_top0@10230000 {
		compatible = "mediatek,dramc_ch1_top0";
		reg = <0x00 0x10230000 0x00 0x2000>;
	};

	dramc_ch1_top1@10232000 {
		compatible = "mediatek,dramc_ch1_top1";
		reg = <0x00 0x10232000 0x00 0x2000>;
	};

	dramc_ch1_top2@10234000 {
		compatible = "mediatek,dramc_ch1_top2";
		reg = <0x00 0x10234000 0x00 0x1000>;
	};

	dramc_ch1_top3@10235000 {
		compatible = "mediatek,dramc_ch1_top3";
		reg = <0x00 0x10235000 0x00 0x1000>;
	};

	dramc_ch1_rsv@10236000 {
		compatible = "mediatek,dramc_ch1_rsv";
		reg = <0x00 0x10236000 0x00 0x2000>;
	};

	gic500@0c000000 {
		compatible = "mediatek,gic500";
		reg = <0x00 0xc000000 0x00 0x00>;
	};

	gic_cpu@0c400000 {
		compatible = "mediatek,gic_cpu";
		reg = <0x00 0xc400000 0x00 0x40000>;
	};

	dfd@0c600000 {
		compatible = "mediatek,dfd";
		reg = <0x00 0xc600000 0x00 0x00>;
	};

	dbg_etb@0d010000 {
		compatible = "mediatek,dbg_etb";
		reg = <0x00 0xd010000 0x00 0x10000>;
	};

	dbg_cti@0d020000 {
		compatible = "mediatek,dbg_cti";
		reg = <0x00 0xd020000 0x00 0x10000>;
	};

	dbg_etr@0d030000 {
		compatible = "mediatek,dbg_etr";
		reg = <0x00 0xd030000 0x00 0x10000>;
	};

	dbg_funnel@0d040000 {
		compatible = "mediatek,dbg_funnel";
		reg = <0x00 0xd040000 0x00 0x10000>;
	};

	dbg_dem@0d0a0000 {
		compatible = "mediatek,dbg_dem";
		reg = <0x00 0xd0a0000 0x00 0x10000>;
		interrupts = <0x00 0x8c 0x08>;
	};

	dbg_mdsys1@0d0c0000 {
		compatible = "mediatek,dbg_mdsys1";
		reg = <0x00 0xd0c0000 0x00 0x40000>;
	};

	dbg_apmcu_mp0@0d400000 {
		compatible = "mediatek,dbg_apmcu_mp0";
		reg = <0x00 0xd400000 0x00 0x1000>;
	};

	dbg_apmcu_mp0@0d410000 {
		compatible = "mediatek,dbg_apmcu_mp0";
		reg = <0x00 0xd410000 0x00 0x1000>;
	};

	dbg_apmcu_mp0@0d420000 {
		compatible = "mediatek,dbg_apmcu_mp0";
		reg = <0x00 0xd420000 0x00 0x1000>;
	};

	dbg_apmcu_mp0@0d430000 {
		compatible = "mediatek,dbg_apmcu_mp0";
		reg = <0x00 0xd430000 0x00 0x1000>;
	};

	dbg_apmcu_mp0@0d440000 {
		compatible = "mediatek,dbg_apmcu_mp0";
		reg = <0x00 0xd440000 0x00 0x1000>;
	};

	dbg_apmcu_mp0@0d510000 {
		compatible = "mediatek,dbg_apmcu_mp0";
		reg = <0x00 0xd510000 0x00 0x1000>;
	};

	dbg_apmcu_mp0@0d520000 {
		compatible = "mediatek,dbg_apmcu_mp0";
		reg = <0x00 0xd520000 0x00 0x1000>;
	};

	dbg_apmcu_mp0@0d530000 {
		compatible = "mediatek,dbg_apmcu_mp0";
		reg = <0x00 0xd530000 0x00 0x1000>;
	};

	dbg_apmcu_mp0@0d540000 {
		compatible = "mediatek,dbg_apmcu_mp0";
		reg = <0x00 0xd540000 0x00 0x1000>;
	};

	dbg_apmcu_mp0@0d610000 {
		compatible = "mediatek,dbg_apmcu_mp0";
		reg = <0x00 0xd610000 0x00 0x1000>;
	};

	dbg_apmcu_mp0@0d620000 {
		compatible = "mediatek,dbg_apmcu_mp0";
		reg = <0x00 0xd620000 0x00 0x1000>;
	};

	dbg_apmcu_mp0@0d630000 {
		compatible = "mediatek,dbg_apmcu_mp0";
		reg = <0x00 0xd630000 0x00 0x1000>;
	};

	dbg_apmcu_mp0@0d640000 {
		compatible = "mediatek,dbg_apmcu_mp0";
		reg = <0x00 0xd640000 0x00 0x1000>;
	};

	dbg_apmcu_mp0@0d710000 {
		compatible = "mediatek,dbg_apmcu_mp0";
		reg = <0x00 0xd710000 0x00 0x1000>;
	};

	dbg_apmcu_mp0@0d720000 {
		compatible = "mediatek,dbg_apmcu_mp0";
		reg = <0x00 0xd720000 0x00 0x1000>;
	};

	dbg_apmcu_mp0@0d730000 {
		compatible = "mediatek,dbg_apmcu_mp0";
		reg = <0x00 0xd730000 0x00 0x1000>;
	};

	dbg_apmcu_mp0@0d740000 {
		compatible = "mediatek,dbg_apmcu_mp0";
		reg = <0x00 0xd740000 0x00 0x1000>;
	};

	dbg_apmcu_mp1@0d800000 {
		compatible = "mediatek,dbg_apmcu_mp1";
		reg = <0x00 0xd800000 0x00 0x00>;
	};

	ap_dma@11000000 {
		compatible = "mediatek,ap_dma";
		reg = <0x00 0x11000000 0x00 0x1000>;
		interrupts = <0x00 0x52 0x08>;
	};

	auxadc@11001000 {
		compatible = "mediatek,auxadc";
		reg = <0x00 0x11001000 0x00 0x1000>;
		interrupts = <0x00 0x4a 0x02>;
		clocks = <0x19 0x22>;
		clock-names = "auxadc-main";
		linux,phandle = <0x3f>;
		phandle = <0x3f>;
	};

	apuart0@11002000 {
		cell-index = <0x00>;
		compatible = "mediatek,mtk-uart";
		reg = <0x00 0x11002000 0x00 0x1000 0x00 0x11000400 0x00 0x80 0x00 0x11000480 0x00 0x80>;
		interrupts = <0x00 0x5b 0x08 0x00 0x68 0x08 0x00 0x69 0x08>;
		clock-frequency = <0x18cba80>;
		clock-div = <0x01>;
		clocks = <0x19 0x14 0x19 0x28>;
		clock-names = "uart0-main", "uart-apdma";
		linux,phandle = <0x40>;
		phandle = <0x40>;
	};

	apuart1@11003000 {
		cell-index = <0x01>;
		compatible = "mediatek,mtk-uart";
		reg = <0x00 0x11003000 0x00 0x1000 0x00 0x11000500 0x00 0x80 0x00 0x11000580 0x00 0x80>;
		interrupts = <0x00 0x5c 0x08 0x00 0x6a 0x08 0x00 0x6b 0x08>;
		clock-frequency = <0x18cba80>;
		clock-div = <0x01>;
		clocks = <0x19 0x15>;
		clock-names = "uart1-main";
		linux,phandle = <0x41>;
		phandle = <0x41>;
	};

	pwm@11006000 {
		compatible = "mediatek,pwm";
		reg = <0x00 0x11006000 0x00 0x1000>;
		interrupts = <0x00 0x4d 0x08>;
		clocks = <0x19 0x0e 0x19 0x0f 0x19 0x10 0x19 0x11 0x19 0x12 0x19 0x32 0x19 0x0d 0x19 0x13>;
		clock-names = "PWM1-main", "PWM2-main", "PWM3-main", "PWM4-main", "PWM5-main", "PWM6-main", "PWM-HCLK-main", "PWM-main";
	};

	i2c@11007000 {
		compatible = "mediatek,mt6739-i2c";
		id = <0x00>;
		reg = <0x00 0x11007000 0x00 0x1000 0x00 0x11000100 0x00 0x80>;
		interrupts = <0x00 0x54 0x08>;
		clocks = <0x19 0x09 0x19 0x28>;
		clock-names = "main", "dma";
		clock-div = <0x05>;
		aed = <0x1f>;
		linux,phandle = <0x42>;
		phandle = <0x42>;
	};

	i2c@11008000 {
		compatible = "mediatek,mt6739-i2c";
		id = <0x01>;
		reg = <0x00 0x11008000 0x00 0x1000 0x00 0x11000180 0x00 0x80>;
		interrupts = <0x00 0x55 0x08>;
		clocks = <0x19 0x0a 0x19 0x28>;
		clock-names = "main", "dma";
		clock-div = <0x05>;
		aed = <0x1f>;
		linux,phandle = <0x43>;
		phandle = <0x43>;
	};

	i2c@11009000 {
		compatible = "mediatek,mt6739-i2c";
		id = <0x02>;
		reg = <0x00 0x11009000 0x00 0x1000 0x00 0x11000200 0x00 0x80>;
		interrupts = <0x00 0x56 0x08>;
		clocks = <0x19 0x0b 0x19 0x28>;
		clock-names = "main", "dma";
		clock-div = <0x05>;
		aed = <0x1f>;
		linux,phandle = <0x44>;
		phandle = <0x44>;
	};

	i2c@1100f000 {
		compatible = "mediatek,mt6739-i2c";
		id = <0x03>;
		reg = <0x00 0x1100f000 0x00 0x1000 0x00 0x11000280 0x00 0x80>;
		interrupts = <0x00 0x57 0x08>;
		clocks = <0x19 0x0c 0x19 0x28>;
		clock-names = "main", "dma";
		clock-div = <0x05>;
		aed = <0x1f>;
		linux,phandle = <0x45>;
		phandle = <0x45>;
	};

	i2c@11011000 {
		compatible = "mediatek,mt6739-i2c";
		id = <0x04>;
		reg = <0x00 0x11011000 0x00 0x1000 0x00 0x11000300 0x00 0x80>;
		interrupts = <0x00 0x58 0x08>;
		clocks = <0x19 0x37 0x19 0x28>;
		clock-names = "main", "dma";
		clock-div = <0x05>;
		aed = <0x1f>;
		linux,phandle = <0x46>;
		phandle = <0x46>;
	};

	i2c@11016000 {
		compatible = "mediatek,mt6739-i2c";
		id = <0x05>;
		reg = <0x00 0x11016000 0x00 0x1000 0x00 0x11000380 0x00 0x80>;
		interrupts = <0x00 0x82 0x08>;
		clocks = <0x19 0x3b 0x19 0x28>;
		clock-names = "main", "dma";
		clock-div = <0x05>;
		aed = <0x1f>;
		linux,phandle = <0x47>;
		phandle = <0x47>;
	};

	spi@1100a000 {
		compatible = "mediatek,mt6739-spi";
		mediatek,pad-select = <0x00>;
		reg = <0x00 0x1100a000 0x00 0x1000>;
		interrupts = <0x00 0x76 0x08>;
		clocks = <0x24 0x0a 0x24 0x30 0x19 0x1b>;
		clock-names = "parent-clk", "sel-clk", "spi-clk";
		linux,phandle = <0x48>;
		phandle = <0x48>;
	};

	spi@11010000 {
		compatible = "mediatek,mt6739-spi";
		mediatek,pad-select = <0x00>;
		reg = <0x00 0x11010000 0x00 0x1000>;
		interrupts = <0x00 0x7a 0x08>;
		clocks = <0x24 0x0a 0x24 0x30 0x19 0x36>;
		clock-names = "parent-clk", "sel-clk", "spi-clk";
		linux,phandle = <0x49>;
		phandle = <0x49>;

		spidev@0 {
			compatible = "rohm,dh2228fv";
			#address-cells = <0x01>;
			#size-cells = <0x01>;
			reg = <0x00>;
			spi-max-frequency = <0x4c4b40>;
		};
	};

	spi@11012000 {
		compatible = "mediatek,mt6739-spi";
		mediatek,pad-select = <0x00>;
		reg = <0x00 0x11012000 0x00 0x1000>;
		interrupts = <0x00 0x80 0x08>;
		clocks = <0x24 0x0a 0x24 0x30 0x19 0x39>;
		clock-names = "parent-clk", "sel-clk", "spi-clk";
		linux,phandle = <0x4a>;
		phandle = <0x4a>;
	};

	therm_ctrl@1100b000 {
		compatible = "mediatek,therm_ctrl";
		reg = <0x00 0x1100b000 0x00 0x1000>;
		interrupts = <0x00 0x4e 0x08>;
		clocks = <0x19 0x08>;
		clock-names = "therm-main";
	};

	eem_fsm@1100b000 {
		compatible = "mediatek,eem_fsm";
		reg = <0x00 0x1100b000 0x00 0x1000>;
		interrupts = <0x00 0x7d 0x08>;
		clocks = <0x24 0x2d 0x24 0x00 0x24 0x20 0x1a 0x00 0x1a 0x01>;
		clock-names = "CLK_TOP_MFG", "CLK_TOP_MFG_OFF", "CLK_TOP_MFG_ON", "CG_SCP_SYS_MFG0", "CG_SCP_SYS_MFG1";
	};

	btif@1100c000 {
		compatible = "mediatek,btif";
		#address-cells = <0x02>;
		#size-cells = <0x02>;
		reg = <0x00 0x1100c000 0x00 0x1000 0x00 0x11000600 0x00 0x80 0x00 0x11000680 0x00 0x80>;
		interrupts = <0x00 0x70 0x08 0x00 0x6c 0x08 0x00 0x6d 0x08>;
		clocks = <0x19 0x1a 0x19 0x28>;
		clock-names = "btifc", "apdmac";
	};

	irtx@1100d000 {
		compatible = "mediatek,irtx";
		reg = <0x00 0x1100d000 0x00 0x1000>;
		interrupts = <0x00 0x7f 0x08>;
	};

	disp_pwm0@1100e000 {
		compatible = "mediatek,disp_pwm0";
		reg = <0x00 0x1100e000 0x00 0x1000>;
	};

	spi2@11010000 {
		compatible = "mediatek,spi2";
		reg = <0x00 0x11010000 0x00 0x1000>;
		interrupts = <0x00 0x80 0x08>;
	};

	spi3@11012000 {
		compatible = "mediatek,spi3";
		reg = <0x00 0x11012000 0x00 0x00>;
		interrupts = <0x00 0x81 0x08>;
	};

	spi4@11013000 {
		compatible = "mediatek,spi4";
		reg = <0x00 0x11013000 0x00 0x1000>;
	};

	nfi@11018000 {
		compatible = "mediatek,nfi";
		reg = <0x00 0x11018000 0x00 0x1000>;
		interrupts = <0x00 0x86 0x08>;
		clocks = <0x24 0x3a 0x24 0x3b 0x25 0x24 0x07 0x24 0x0c 0x24 0x06 0x24 0x08 0x24 0x23 0x24 0x15 0x24 0x1c 0x24 0x0d 0x24 0x19 0x24 0x02 0x24 0x18 0x24 0x09 0x19 0x1e 0x19 0x27 0x19 0x4f>;
		clock-names = "nfi2x_sel", "nfiecc_sel", "clk26m", "syspll2_d2", "syspll_d7", "syspll_d3", "syspll2_d4", "msdcpll_d2", "univpll1_d2", "univpll_d5", "syspll4_d2", "univpll2_d4", "syspll1_d2", "univpll2_d2", "syspll_d5", "infra_nfiecc", "infra_nfi", "infra_nfi_1x";
	};

	nfiecc@11019000 {
		compatible = "mediatek,nfiecc";
		reg = <0x00 0x11019000 0x00 0x1000>;
		interrupts = <0x00 0x87 0x08>;
	};

	msdc@11230000 {
		compatible = "mediatek,msdc";
		reg = <0x00 0x11230000 0x00 0x10000 0x00 0x11cd0000 0x00 0x10000>;
		interrupts = <0x00 0x4f 0x08>;
		index = [00];
		clk_src = [01];
		bus-width = <0x08>;
		max-frequency = <0xbebc200>;
		cap-mmc-highspeed;
		msdc-sys-suspend;
		mmc-ddr-1_8v;
		mmc-hs200-1_8v;
		mmc-hs400-1_8v;
		non-removable;
		pinctl = <0x26>;
		register_setting = <0x27>;
		host_function = [00];
		status = "okay";
		vmmc-supply = <0x28>;
		clocks = <0x19 0x4b 0x19 0x1c>;
		clock-names = "msdc0-clock", "msdc0-hclock";
		hw_dvfs = [00];
		linux,phandle = <0x4b>;
		phandle = <0x4b>;

		msdc0@default {
			linux,phandle = <0x26>;
			phandle = <0x26>;

			pins_cmd {
				drive-strength = [04];
			};

			pins_dat {
				drive-strength = [04];
			};

			pins_clk {
				drive-strength = [04];
			};

			pins_rst {
				drive-strength = [04];
			};

			pins_ds {
				drive-strength = [04];
			};
		};

		msdc0@register_default {
			cmd_edge = [00];
			rdata_edge = [00];
			wdata_edge = [00];
			linux,phandle = <0x27>;
			phandle = <0x27>;
		};
	};

	msdc@11240000 {
		compatible = "mediatek,msdc";
		reg = <0x00 0x11240000 0x00 0x10000 0x00 0x11c40000 0x00 0x10000>;
		interrupts = <0x00 0x50 0x08>;
		index = [01];
		clk_src = [02];
		bus-width = <0x04>;
		max-frequency = <0xbebc200>;
		msdc-sys-suspend;
		cap-sd-highspeed;
		sd-uhs-sdr12;
		sd-uhs-sdr25;
		sd-uhs-sdr50;
		sd-uhs-sdr104;
		sd-uhs-ddr50;
		pinctl = <0x29>;
		pinctl_sdr104 = <0x2a>;
		pinctl_sdr50 = <0x2b>;
		pinctl_ddr50 = <0x2c>;
		register_setting = <0x2d>;
		host_function = [01];
		cd_level = [00];
		cd-gpios = <0x2e 0x05 0x00>;
		status = "okay";
		vmmc-supply = <0x2f>;
		vqmmc-supply = <0x30>;
		clocks = <0x19 0x4c 0x19 0x1d>;
		clock-names = "msdc1-clock", "msdc1-hclock";
		hw_dvfs = [00];
		linux,phandle = <0x4c>;
		phandle = <0x4c>;

		msdc1@default {
			linux,phandle = <0x29>;
			phandle = <0x29>;

			pins_cmd {
				drive-strength = [03];
			};

			pins_dat {
				drive-strength = [03];
			};

			pins_clk {
				drive-strength = [03];
			};
		};

		msdc1@sdr104 {
			linux,phandle = <0x2a>;
			phandle = <0x2a>;

			pins_cmd {
				drive-strength = [03];
			};

			pins_dat {
				drive-strength = [03];
			};

			pins_clk {
				drive-strength = [03];
			};
		};

		msdc1@sdr50 {
			linux,phandle = <0x2b>;
			phandle = <0x2b>;

			pins_cmd {
				drive-strength = [03];
			};

			pins_dat {
				drive-strength = [03];
			};

			pins_clk {
				drive-strength = [03];
			};
		};

		msdc1@ddr50 {
			linux,phandle = <0x2c>;
			phandle = <0x2c>;

			pins_cmd {
				drive-strength = [03];
			};

			pins_dat {
				drive-strength = [03];
			};

			pins_clk {
				drive-strength = [03];
			};
		};

		msdc1@register_default {
			cmd_edge = [00];
			rdata_edge = [00];
			wdata_edge = [00];
			linux,phandle = <0x2d>;
			phandle = <0x2d>;
		};
	};

	usb0@11200000 {
		compatible = "mediatek,mt6739-usb20";
		reg = <0x00 0x11200000 0x00 0x10000 0x00 0x11cc0000 0x00 0x10000>;
		interrupts = <0x00 0x49 0x08>;
		mode = <0x02>;
		multipoint = <0x01>;
		num_eps = <0x10>;
		clocks = <0x19 0x06 0x24 0x3c 0x24 0x1e>;
		clock-names = "usb0", "usb0_clk_top_sel", "usb0_clk_univpll3_d4";
	};

	btcvsd@10001000 {
		compatible = "mediatek,audio_bt_cvsd";
		offset = <0xf00 0x800 0xfd0 0xfd4 0xfd8>;
		reg = <0x00 0x10001000 0x00 0x1000 0x00 0x18000000 0x00 0x10000 0x00 0x18080000 0x00 0x8000>;
		interrupts = <0x00 0xe8 0x08>;
	};

	audio@11220000 {
		compatible = "mediatek,audio", "syscon";
		reg = <0x00 0x11220000 0x00 0x1000>;
		#clock-cells = <0x01>;
		linux,phandle = <0x31>;
		phandle = <0x31>;
	};

	mt_soc_dl1_pcm@11220000 {
		compatible = "mediatek,mt_soc_pcm_dl1";
		reg = <0x00 0x11220000 0x00 0x1000>;
		interrupts = <0x00 0x99 0x08>;
		clocks = <0x31 0x00 0x31 0x04 0x31 0x05 0x31 0x03 0x31 0x01 0x31 0x02 0x31 0x06 0x19 0x2d 0x19 0x35 0x24 0x34 0x24 0x35 0x24 0x03 0x24 0x38 0x24 0x24 0x24 0x42 0x24 0x27 0x32 0x06 0x25>;
		clock-names = "aud_afe_clk", "aud_dac_clk", "aud_dac_predis_clk", "aud_adc_clk", "aud_apll22m_clk", "aud_apll1_tuner_clk", "aud_tml_clk", "aud_infra_clk", "mtkaif_26m_clk", "top_mux_audio", "top_mux_audio_int", "top_sys_pll1_d4", "top_mux_aud_1", "top_apll1_ck", "top_mux_aud_eng1", "top_apll1_d8", "apmixed_apll1", "top_clk26m_clk";
		linux,phandle = <0x4d>;
		phandle = <0x4d>;
	};

	audio_sram@11221000 {
		compatible = "mediatek,audio_sram";
		reg = <0x00 0x11221000 0x00 0x9000>;
	};

	mt_soc_btcvsd_rx_pcm {
		compatible = "mediatek,mt_soc_btcvsd_rx_pcm";
	};

	mt_soc_btcvsd_tx_pcm {
		compatible = "mediatek,mt_soc_btcvsd_tx_pcm";
	};

	mt_soc_deep_buffer_dl_pcm {
		compatible = "mediatek,mt_soc_pcm_deep_buffer_dl";
	};

	mt_soc_ul1_pcm {
		compatible = "mediatek,mt_soc_pcm_capture";
	};

	mt_soc_voice_md1 {
		compatible = "mediatek,mt_soc_pcm_voice_md1";
	};

	mt_soc_hdmi_pcm {
		compatible = "mediatek,mt_soc_pcm_hdmi";
	};

	mt_soc_uldlloopback_pcm {
		compatible = "mediatek,mt_soc_pcm_uldlloopback";
	};

	mt_soc_i2s0_pcm {
		compatible = "mediatek,mt_soc_pcm_dl1_i2s0";
	};

	mt_soc_mrgrx_pcm {
		compatible = "mediatek,mt_soc_pcm_mrgrx";
	};

	mt_soc_mrgrx_awb_pcm {
		compatible = "mediatek,mt_soc_pcm_mrgrx_awb";
	};

	mt_soc_fm_i2s_pcm {
		compatible = "mediatek,mt_soc_pcm_fm_i2s";
	};

	mt_soc_fm_i2s_awb_pcm {
		compatible = "mediatek,mt_soc_pcm_fm_i2s_awb";
	};

	mt_soc_i2s0dl1_pcm {
		compatible = "mediatek,mt_soc_pcm_dl1_i2s0dl1";
	};

	mt_soc_dl1_awb_pcm {
		compatible = "mediatek,mt_soc_pcm_dl1_awb";
	};

	mt_soc_voice_md1_bt {
		compatible = "mediatek,mt_soc_pcm_voice_md1_bt";
	};

	mt_soc_voip_bt_out {
		compatible = "mediatek,mt_soc_pcm_dl1_bt";
	};

	mt_soc_voip_bt_in {
		compatible = "mediatek,mt_soc_pcm_bt_dai";
	};

	mt_soc_tdmrx_pcm {
		compatible = "mediatek,mt_soc_tdm_capture";
	};

	mt_soc_fm_mrgtx_pcm {
		compatible = "mediatek,mt_soc_pcm_fmtx";
	};

	mt_soc_ul2_pcm {
		compatible = "mediatek,mt_soc_pcm_capture2";
	};

	mt_soc_i2s0_awb_pcm {
		compatible = "mediatek,mt_soc_pcm_i2s0_awb";
	};

	mt_soc_voice_md2 {
		compatible = "mediatek,mt_soc_pcm_voice_md2";
	};

	mt_soc_routing_pcm {
		compatible = "mediatek,mt_soc_pcm_routing";
	};

	mt_soc_voice_md2_bt {
		compatible = "mediatek,mt_soc_pcm_voice_md2_bt";
	};

	mt_soc_hp_impedance_pcm {
		compatible = "mediatek,mt_soc_pcm_hp_impedance";
	};

	mt_soc_codec_name {
		compatible = "mediatek,mt_soc_codec_63xx";
		use_hp_depop_flow = <0x00>;
		use_ul_260k = <0x00>;
	};

	mt_soc_dummy_pcm {
		compatible = "mediatek,mt_soc_pcm_dummy";
	};

	mt_soc_codec_dummy_name {
		compatible = "mediatek,mt_soc_codec_dummy";
	};

	mt_soc_routing_dai_name {
		compatible = "mediatek,mt_soc_dai_routing";
	};

	mt_soc_dai_name {
		compatible = "mediatek,mt_soc_dai_stub";
	};

	mt_soc_dl2_pcm {
		compatible = "mediatek,mt_soc_pcm_dl2";
	};

	mt_soc_anc_pcm {
		compatible = "mediatek,mt_soc_pcm_anc";
	};

	mt_soc_pcm_voice_ultra {
		compatible = "mediatek,mt_soc_pcm_voice_ultra";
	};

	mt_soc_pcm_voice_usb {
		compatible = "mediatek,mt_soc_pcm_voice_usb";
	};

	mt_soc_pcm_voice_usb_echoref {
		compatible = "mediatek,mt_soc_pcm_voice_usb_echoref";
	};

	wifi@180f0000 {
		compatible = "mediatek,wifi";
		reg = <0x00 0x180f0000 0x00 0x5c>;
		interrupts = <0x00 0xea 0x08>;
		dma_addrmask = <0x24>;
		clocks = <0x19 0x28>;
		clock-names = "wifi-dma";
	};

	efusec@11c00000 {
		compatible = "mediatek,efusec";
		reg = <0x00 0x11c00000 0x00 0x10000>;
	};

	mipi_rx_ana_csi0@11c10000 {
		compatible = "mediatek,mipi_rx_ana_csi0";
		reg = <0x00 0x11c10000 0x00 0x10000>;
	};

	mipi_rx_ana_csi1@11c20000 {
		compatible = "mediatek,mipi_rx_ana_csi1";
		reg = <0x00 0x11c20000 0x00 0x10000>;
	};

	msdc1_pad_macro@11c40000 {
		compatible = "mediatek,msdc1_pad_macro";
		reg = <0x00 0x11c40000 0x00 0x10000>;
	};

	msdc0_pad_macro@11cd0000 {
		compatible = "mediatek,msdc0_pad_macro";
		reg = <0x00 0x11cd0000 0x00 0x10000>;
	};

	mfg_auckland@13000000 {
		compatible = "mediatek,AUCKLAND";
		reg = <0x00 0x13000000 0x00 0x80000>;
		interrupts = <0x00 0xe2 0x08>;
		interrupt-names = "RGX";
		clock-frequency = <0x21f98280>;
		clocks = <0x24 0x2d 0x25 0x24 0x20 0x1a 0x00 0x1a 0x01>;
		clock-names = "CLK_TOP_MFG", "CLK_TOP_MFG_OFF", "CLK_TOP_MFG_ON", "CG_SCP_SYS_MFG0", "CG_SCP_SYS_MFG1";
	};

	mfg_cfg@13ffe000 {
		compatible = "mediatek,mt6739-mfg_cfg", "syscon";
		reg = <0x00 0x13ffe000 0x00 0x1000>;
	};

	gpufreq {
		compatible = "mediatek,mt6739-gpufreq";
		clocks = <0x24 0x2d 0x25 0x24 0x20>;
		clock-names = "CLK_TOP_MFG", "CLK_TOP_MFG_OFF", "CLK_TOP_MFG_ON";
	};

	mmsys_config@14000000 {
		compatible = "mediatek,mmsys_config", "syscon";
		reg = <0x00 0x14000000 0x00 0x1000>;
		interrupts = <0x00 0xd3 0x08>;
		#clock-cells = <0x01>;
		clocks = <0x1b 0x04>;
		clock-names = "CAM_MDP";
		linux,phandle = <0x1b>;
		phandle = <0x1b>;
	};

	touch {
		compatible = "mediatek,mt6739-touch";
		linux,phandle = <0x4e>;
		phandle = <0x4e>;
	};

	flashlight_core {
		compatible = "mediatek,flashlight_core";
		linux,phandle = <0x4f>;
		phandle = <0x4f>;
	};

	flashlights_rt4505 {
		compatible = "mediatek,flashlights_rt4505";
		linux,phandle = <0x50>;
		phandle = <0x50>;
	};

	flashlights_dummy_gpio {
		compatible = "mediatek,flashlights_dummy_gpio";
		linux,phandle = <0x51>;
		phandle = <0x51>;
	};

	sub_flashlights_dummy_gpio {
		compatible = "mediatek,sub_flashlights_dummy_gpio";
		linux,phandle = <0x52>;
		phandle = <0x52>;
	};

	mtkfb {
		compatible = "mediatek,mtkfb";
		linux,phandle = <0x53>;
		phandle = <0x53>;
	};

	disp_mutex@14001000 {
		compatible = "mediatek,disp_mutex";
		reg = <0x00 0x14001000 0x00 0x1000>;
		interrupts = <0x00 0xc2 0x08>;
		linux,phandle = <0x22>;
		phandle = <0x22>;
	};

	smi_common@14002000 {
		compatible = "mediatek,smi_common";
		reg = <0x00 0x14002000 0x00 0x1000>;
		larbs = <0x33 0x34 0x35>;
		clocks = <0x1a 0x04 0x1b 0x02 0x1b 0x03 0x1b 0x00 0x24 0x2c 0x24 0x21 0x24 0x07>;
		clock-names = "mtcmos-mm", "smi-common-gals0", "smi-common-gals1", "smi-common", "MMDVFS_CLK_TOP_MMPLL_CK", "mmdvfs_clk_top_vencpll_ck", "mmdvfs_clk_top_syspll2_d2";
	};

	lcm_mode {
		compatible = "mediatek,lcm_mode";
		linux,phandle = <0x54>;
		phandle = <0x54>;
	};

	smi_larb0@14003000 {
		compatible = "mediatek,smi_larb0";
		reg = <0x00 0x14003000 0x00 0x1000>;
		interrupts = <0x00 0xdf 0x08>;
		clocks = <0x1a 0x04 0x1b 0x01>;
		clock-names = "mtcmos-mm", "mm-larb0";
		linux,phandle = <0x33>;
		phandle = <0x33>;
	};

	mdp_rdma0@14004000 {
		compatible = "mediatek,mdp_rdma0";
		reg = <0x00 0x14004000 0x00 0x1000>;
		interrupts = <0x00 0xc3 0x08>;
		clocks = <0x1b 0x05>;
		clock-names = "MDP_RDMA0";
		linux,phandle = <0x1c>;
		phandle = <0x1c>;
	};

	mdp_rsz0@14005000 {
		compatible = "mediatek,mdp_rsz0";
		reg = <0x00 0x14005000 0x00 0x1000>;
		interrupts = <0x00 0xc4 0x08>;
		clocks = <0x1b 0x06>;
		clock-names = "MDP_RSZ0";
		linux,phandle = <0x1d>;
		phandle = <0x1d>;
	};

	mdp_rsz1@14006000 {
		compatible = "mediatek,mdp_rsz1";
		reg = <0x00 0x14006000 0x00 0x1000>;
		interrupts = <0x00 0xc5 0x08>;
		clocks = <0x1b 0x07>;
		clock-names = "MDP_RSZ1";
		linux,phandle = <0x1e>;
		phandle = <0x1e>;
	};

	mdp_wdma0@14007000 {
		compatible = "mediatek,mdp_wdma0";
		reg = <0x00 0x14007000 0x00 0x1000>;
		interrupts = <0x00 0xc8 0x08>;
		clocks = <0x1b 0x0a>;
		clock-names = "MDP_WDMA";
		linux,phandle = <0x1f>;
		phandle = <0x1f>;
	};

	mdp_wrot0@14008000 {
		compatible = "mediatek,mdp_wrot0";
		reg = <0x00 0x14008000 0x00 0x1000>;
		interrupts = <0x00 0xc7 0x08>;
		clocks = <0x1b 0x09>;
		clock-names = "MDP_WROT0";
		linux,phandle = <0x20>;
		phandle = <0x20>;
	};

	mdp_tdshp0@14009000 {
		compatible = "mediatek,mdp_tdshp0";
		reg = <0x00 0x14009000 0x00 0x1000>;
		clocks = <0x1b 0x08>;
		clock-names = "MDP_TDSHP";
		linux,phandle = <0x21>;
		phandle = <0x21>;
	};

	disp_ovl0@1400a000 {
		compatible = "mediatek,disp_ovl0";
		reg = <0x00 0x1400a000 0x00 0x1000>;
		interrupts = <0x00 0xc9 0x08>;
		clocks = <0x1b 0x0c>;
		clock-names = "DISP_OVL0";
		linux,phandle = <0x23>;
		phandle = <0x23>;
	};

	disp_rdma0@1400b000 {
		compatible = "mediatek,disp_rdma0";
		reg = <0x00 0x1400b000 0x00 0x1000>;
		interrupts = <0x00 0xca 0x08>;
	};

	disp_wdma0@1400c000 {
		compatible = "mediatek,disp_wdma0";
		reg = <0x00 0x1400c000 0x00 0x1000>;
		interrupts = <0x00 0xcb 0x08>;
	};

	disp_color0@1400d000 {
		compatible = "mediatek,disp_color0";
		reg = <0x00 0x1400d000 0x00 0x1000>;
		interrupts = <0x00 0xcc 0x08>;
	};

	disp_ccorr0@1400e000 {
		compatible = "mediatek,disp_ccorr0";
		reg = <0x00 0x1400e000 0x00 0x1000>;
		interrupts = <0x00 0xcd 0x08>;
	};

	disp_aal0@1400f000 {
		compatible = "mediatek,disp_aal0";
		reg = <0x00 0x1400f000 0x00 0x1000>;
		interrupts = <0x00 0xce 0x08>;
		aal_support = <0x01>;
		linux,phandle = <0x55>;
		phandle = <0x55>;
	};

	disp_gamma0@14010000 {
		compatible = "mediatek,disp_gamma0";
		reg = <0x00 0x14010000 0x00 0x1000>;
		interrupts = <0x00 0xcf 0x08>;
	};

	disp_dither0@14011000 {
		compatible = "mediatek,disp_dither0";
		reg = <0x00 0x14011000 0x00 0x1000>;
		interrupts = <0x00 0xd0 0x08>;
	};

	dsi0@14012000 {
		compatible = "mediatek,dsi0";
		reg = <0x00 0x14012000 0x00 0x1000>;
		interrupts = <0x00 0xd1 0x08>;
	};

	dispsys@14000000 {
		compatible = "mediatek,dispsys";
		clocks = <0x1a 0x04 0x1b 0x00 0x1b 0x01 0x1b 0x02 0x1b 0x03 0x1b 0x0c 0x1b 0x0d 0x1b 0x0e 0x1b 0x0f 0x1b 0x10 0x1b 0x11 0x1b 0x12 0x1b 0x13 0x1b 0x14 0x1b 0x15 0x1b 0x18 0x1b 0x09 0x19 0x33 0x24 0x39 0x25 0x24 0x19 0x24 0x1a 0x24 0x1f>;
		clock-names = "CLK_MM_MTCMOS", "CLK_MM_SMI_COMMON", "CLK_MM_SMI_LARB0", "CLK_MM_GALS_COMM0", "CLK_MM_GALS_COMM1", "CLK_MM_DISP_OVL0", "CLK_MM_DISP_RDMA0", "CLK_MM_DISP_WDMA0", "CLK_MM_DISP_COLOR0", "CLK_MM_DISP_CCORR0", "CLK_MM_DISP_AAL0", "CLK_MM_DISP_GAMMA0", "CLK_MM_DISP_DITHER0", "CLK_MM_DSI_MM_CLOCK", "CLK_MM_DSI_INTERF", "CLK_MM_F26M_HRT", "MDP_WROT0", "DISP_PWM", "MUX_PWM", "CLK26M", "UNIVPLL2_D4", "UNIVPLL2_D8", "UNIVPLL3_D8";
		linux,phandle = <0x56>;
		phandle = <0x56>;
	};

	dbi0@14013000 {
		compatible = "mediatek,dbi0";
		reg = <0x00 0x14013000 0x00 0x1000>;
		interrupts = <0x00 0xd2 0x08>;
	};

	mm_mutex@14016000 {
		compatible = "mediatek,mm_mutex";
		reg = <0x00 0x14016000 0x00 0x00>;
		linux,phandle = <0x57>;
		phandle = <0x57>;
	};

	imgsys_config@15000000 {
		compatible = "mediatek,imgsys", "syscon";
		reg = <0x00 0x15000000 0x00 0x1000>;
		#clock-cells = <0x01>;
		linux,phandle = <0x36>;
		phandle = <0x36>;
	};

	ispsys@15000000 {
		compatible = "mediatek,mt6739-ispsys";
		reg = <0x00 0x15004000 0x00 0x9000 0x00 0x1500d000 0x00 0x1000 0x00 0x15000000 0x00 0x10000 0x00 0x10215000 0x00 0x3000 0x00 0x10211000 0x00 0x1000>;
		interrupts = <0x00 0xd9 0x08 0x00 0xda 0x08 0x00 0xdb 0x08 0x00 0xdc 0x08 0x00 0xdd 0x08>;
		clocks = <0x1a 0x04 0x1a 0x05 0x36 0x01 0x36 0x02 0x36 0x03 0x36 0x04 0x36 0x05>;
		clock-names = "CG_SCP_SYS_MM0", "CG_SCP_SYS_ISP", "CG_IMG_CAM_SMI", "CG_IMG_CAM_CAM", "CG_IMG_SEN_TG", "CG_IMG_SEN_CAM", "CG_IMG_CAM_SV";
	};

	smi_larb2@15001000 {
		compatible = "mediatek,smi_larb2";
		reg = <0x00 0x15001000 0x00 0x1000>;
		interrupts = <0x00 0xde 0x08>;
		clocks = <0x1a 0x05 0x36 0x00>;
		clock-names = "mtcmos-img", "img-larb2";
		linux,phandle = <0x35>;
		phandle = <0x35>;
	};

	cam_a@15004000 {
		compatible = "mediatek,cam_a";
		reg = <0x00 0x15004000 0x00 0x1000>;
	};

	cam_b@15005000 {
		compatible = "mediatek,cam_b";
		reg = <0x00 0x15005000 0x00 0x1000>;
		interrupts = <0x00 0xd9 0x08>;
	};

	cam_c@15006000 {
		compatible = "mediatek,cam_c";
		reg = <0x00 0x15006000 0x00 0x1000>;
		interrupts = <0x00 0xda 0x08>;
	};

	cam_d@15007000 {
		compatible = "mediatek,cam_d";
		reg = <0x00 0x15007000 0x00 0x1000>;
		interrupts = <0x00 0xdb 0x08>;
	};

	seninf@15008000 {
		compatible = "mediatek,seninf";
		reg = <0x00 0x15008000 0x00 0x1000>;
	};

	camsv@15009000 {
		compatible = "mediatek,camsv";
		reg = <0x00 0x15009000 0x00 0x1000>;
		interrupts = <0x00 0xdc 0x08>;
	};

	cam_a_inner@1500d000 {
		compatible = "mediatek,cam_a_inner";
		reg = <0x00 0x1500d000 0x00 0x1000>;
	};

	cam_c_inner@1500e000 {
		compatible = "mediatek,cam_c_inner";
		reg = <0x00 0x1500e000 0x00 0x1000>;
	};

	cam_d_inner@1500f000 {
		compatible = "mediatek,cam_d_inner";
		reg = <0x00 0x1500f000 0x00 0x1000>;
	};

	venc_global_con@17000000 {
		compatible = "mediatek,venc_global_con", "syscon";
		reg = <0x00 0x17000000 0x00 0x10000>;
		#clock-cells = <0x01>;
		linux,phandle = <0x37>;
		phandle = <0x37>;
	};

	vdec_gcon@17000000 {
		compatible = "mediatek,vdec_gcon";
		reg = <0x00 0x17000000 0x00 0x1000>;
		clocks = <0x37 0x03 0x37 0x01 0x1a 0x06 0x1a 0x06>;
		clock-names = "MT_CG_VDEC", "MT_CG_VENC", "MT_SCP_SYS_VDE", "MT_SCP_SYS_VEN";
	};

	venc_jpg@17030000 {
		compatible = "mediatek,venc_jpg";
		reg = <0x00 0x17030000 0x00 0x1000>;
		interrupts = <0x00 0xd6 0x08>;
		clocks = <0x37 0x02>;
		clock-names = "MT_CG_VENC_JPGENC";
	};

	vdec@17040000 {
		compatible = "mediatek,vdec";
		reg = <0x00 0x17040000 0x00 0x10000>;
		interrupts = <0x00 0xd7 0x08>;
	};

	smi_larb3@17010000 {
		compatible = "mediatek,smi_larb3";
		reg = <0x00 0x17010000 0x00 0x1000>;
		interrupts = <0x00 0xe7 0x08>;
	};

	venc@17020000 {
		compatible = "mediatek,venc";
		reg = <0x00 0x17020000 0x00 0x1000>;
		interrupts = <0x00 0xd4 0x08>;
		linux,phandle = <0x58>;
		phandle = <0x58>;
	};

	smi_larb1@17010000 {
		compatible = "mediatek,smi_larb1";
		reg = <0x00 0x17010000 0x00 0x1000>;
		interrupts = <0x00 0xd5 0x08>;
		clocks = <0x1a 0x06 0x37 0x00 0x37 0x01>;
		clock-names = "mtcmos-ven", "venc-larb", "venc-venc";
		linux,phandle = <0x34>;
		phandle = <0x34>;
	};

	mt6357_gauge {
		compatible = "mediatek,mt6357_gauge";
		gauge_name = "gauge";
		alias_name = "mt6357";
	};

	gauge_timer {
		compatible = "mediatek,gauge_timer_service";
	};

	bat_gm30 {
		compatible = "mediatek,bat_gm30";
		DIFFERENCE_FULLOCV_ITH = <0xaa>;
		SHUTDOWN_1_TIME = <0x3c>;
		KEEP_100_PERCENT = <0x03>;
		R_FG_VALUE = <0x0a>;
		EMBEDDED_SEL = <0x00>;
		PMIC_SHUTDOWN_CURRENT = <0x14>;
		FG_METER_RESISTANCE = <0xc8>;
		CAR_TUNE_VALUE = <0x5e>;
		TEMPERATURE_T0 = <0x32>;
		TEMPERATURE_T1 = <0x19>;
		TEMPERATURE_T2 = <0x0a>;
		TEMPERATURE_T3 = <0x00>;
		TEMPERATURE_T4 = <0xfffffff6>;
		g_FG_PSEUDO100_T0 = <0x62>;
		g_FG_PSEUDO100_T1 = <0x62>;
		g_FG_PSEUDO100_T2 = <0x5f>;
		g_FG_PSEUDO100_T3 = <0x5a>;
		g_FG_PSEUDO100_T4 = <0x50>;
		Q_MAX_SYS_VOLTAGE_BAT0 = <0xd48>;
		Q_MAX_SYS_VOLTAGE_BAT1 = <0xd48>;
		Q_MAX_SYS_VOLTAGE_BAT2 = <0xd48>;
		Q_MAX_SYS_VOLTAGE_BAT3 = <0xd48>;
		battery0_profile_t0_num = <0x64>;
		battery0_profile_t0 = <0x00 0xab68 0x500 0x167 0xaad8 0x4fc 0x2ce 0xaa4d 0x4f0 0x436 0xa9c8 0x4e2 0x59d 0xa94d 0x4e2 0x704 0xa8d3 0x4d3 0x86b 0xa859 0x4c9 0x9d2 0xa7df 0x4c9 0xb3a 0xa765 0x4c9 0xca1 0xa6f0 0x4c9 0xe08 0xa67b 0x4c4 0xf6f 0xa601 0x4b2 0x10d6 0xa58d 0x4c0 0x123d 0xa51a 0x4c9 0x13a5 0xa4a7 0x4c9 0x150c 0xa434 0x4c9 0x1673 0xa3c1 0x4d5 0x17da 0xa34e 0x4e2 0x1941 0xa2db 0x4e2 0x1aa9 0xa26f 0x4e2 0x1c10 0xa203 0x4eb 0x1d77 0xa196 0x4f9 0x1ede 0xa123 0x4e7 0x2045 0xa0b6 0x4e2 0x21ad 0xa04c 0x4e8 0x2314 0x9fe8 0x4fa 0x247b 0x9f7a 0x4fb 0x25e2 0x9f12 0x505 0x2749 0x9eae 0x517 0x28b1 0x9e51 0x529 0x2a18 0x9dee 0x52d 0x2b7f 0x9d8c 0x52d 0x2ce6 0x9d2f 0x52d 0x2e4d 0x9cd2 0x52d 0x2fb5 0x9c74 0x538 0x311c 0x9c18 0x54a 0x3283 0x9bc2 0x55c 0x33ea 0x9b6c 0x56e 0x3551 0x9b16 0x578 0x36b8 0x9ac0 0x579 0x3820 0x9a69 0x58b 0x3987 0x9a13 0x59d 0x3aee 0x99b7 0x5a0 0x3c55 0x994b 0x57c 0x3dbc 0x98d9 0x559 0x3f24 0x9866 0x52c 0x408b 0x97f5 0x4f8 0x41f2 0x9798 0x4d4 0x4359 0x974a 0x4c9 0x44c0 0x9704 0x4c9 0x4628 0x96c3 0x4c9 0x478f 0x9689 0x4c9 0x48f6 0x9654 0x4d2 0x4a5d 0x9620 0x4e0 0x4bc4 0x95e7 0x4ce 0x4d2c 0x95b3 0x4c9 0x4e93 0x9583 0x4cf 0x4ffa 0x9558 0x4e1 0x5161 0x952d 0x4e2 0x52c8 0x9502 0x4e2 0x5430 0x94d8 0x4e5 0x5597 0x94b4 0x4f7 0x56fe 0x9490 0x4fb 0x5865 0x946c 0x502 0x59cc 0x9448 0x514 0x5b33 0x942b 0x526 0x5c9b 0x940a 0x52d 0x5e02 0x93e8 0x531 0x5f69 0x93cb 0x543 0x60d0 0x93a3 0x537 0x6237 0x9371 0x51e 0x639f 0x9337 0x4fa 0x6506 0x92f0 0x4e8 0x666d 0x92b1 0x4e2 0x67d4 0x9279 0x4dd 0x693b 0x9247 0x4cc 0x6aa3 0x921a 0x4d9 0x6c0a 0x91eb 0x4d9 0x6d71 0x91ba 0x4cb 0x6ed8 0x9196 0x4dd 0x703f 0x9172 0x4ef 0x71a7 0x9148 0x4f5 0x730e 0x910e 0x4e3 0x7475 0x90ce 0x4e2 0x75dc 0x9091 0x4ec 0x7743 0x9055 0x4f8 0x78ab 0x9006 0x4e6 0x7a12 0x8fc7 0x4c7 0x7b79 0x8f9d 0x4b6 0x7ce0 0x8f8e 0x4c8 0x7e47 0x8f87 0x4ec 0x7fae 0x8f7c 0x51a 0x8116 0x8f68 0x553 0x827d 0x8f3d 0x59b 0x83e4 0x8e73 0x563 0x854b 0x8d1a 0x526 0x86b2 0x8b29 0x514 0x881a 0x884c 0x55c 0x8981 0x83f4 0x5fc 0x8ae8 0x7ee0 0x4c9>;
		battery0_profile_t1_num = <0x64>;
		battery0_profile_t1 = <0x00 0xab36 0x6c2 0x167 0xaa9f 0x6be 0x2ce 0xaa1a 0x6c8 0x436 0xa9a0 0x6d6 0x59d 0xa925 0x6d6 0x704 0xa8a5 0x6c7 0x86b 0xa82a 0x6c5 0x9d2 0xa7b7 0x6d6 0xb3a 0xa73d 0x6d6 0xca1 0xa6c3 0x6ca 0xe08 0xa64b 0x6c2 0xf6f 0xa5d8 0x6d4 0x10d6 0xa55e 0x6c6 0x123d 0xa4eb 0x6c5 0x13a5 0xa47f 0x6d6 0x150c 0xa40c 0x6d6 0x1673 0xa399 0x6d6 0x17da 0xa328 0x6db 0x1941 0xa2bc 0x6ed 0x1aa9 0xa24a 0x6ef 0x1c10 0xa1db 0x6f8 0x1d77 0xa16e 0x706 0x1ede 0xa0fb 0x6f4 0x2045 0xa093 0x709 0x21ad 0xa02c 0x721 0x2314 0x9fc0 0x721 0x247b 0x9f59 0x732 0x25e2 0x9f04 0x759 0x2749 0x9ebb 0x788 0x28b1 0x9e6c 0x79a 0x2a18 0x9dea 0x781 0x2b7f 0x9d54 0x76c 0x2ce6 0x9cb7 0x76c 0x2e4d 0x9c44 0x77e 0x2fb5 0x9beb 0x79b 0x311c 0x9ba7 0x7bb 0x3283 0x9b6d 0x7cd 0x33ea 0x9b22 0x7d0 0x3551 0x9ad0 0x7c8 0x36b8 0x9a79 0x7b7 0x3820 0x9a1c 0x7b7 0x3987 0x99ba 0x793 0x3aee 0x9951 0x75e 0x3c55 0x98de 0x728 0x3dbc 0x9878 0x724 0x3f24 0x9813 0x726 0x408b 0x97b1 0x726 0x41f2 0x976a 0x726 0x4359 0x9722 0x726 0x44c0 0x96dc 0x726 0x4628 0x969b 0x726 0x478f 0x9668 0x726 0x48f6 0x9632 0x726 0x4a5d 0x95fa 0x726 0x4bc4 0x95cf 0x726 0x4d2c 0x959f 0x726 0x4e93 0x956f 0x726 0x4ffa 0x9544 0x726 0x5161 0x9519 0x726 0x52c8 0x94f2 0x726 0x5430 0x94ce 0x726 0x5597 0x94aa 0x726 0x56fe 0x9486 0x726 0x5865 0x9462 0x726 0x59cc 0x943e 0x726 0x5b33 0x9421 0x726 0x5c9b 0x9400 0x726 0x5e02 0x93dc 0x726 0x5f69 0x93b8 0x726 0x60d0 0x939a 0x726 0x6237 0x937b 0x726 0x639f 0x9357 0x726 0x6506 0x933a 0x726 0x666d 0x9314 0x726 0x67d4 0x92eb 0x726 0x693b 0x92c7 0x726 0x6aa3 0x929c 0x726 0x6c0a 0x9271 0x726 0x6d71 0x9246 0x726 0x6ed8 0x9222 0x726 0x703f 0x91f9 0x726 0x71a7 0x91c7 0x726 0x730e 0x9187 0x726 0x7475 0x9146 0x726 0x75dc 0x9105 0x726 0x7743 0x90c2 0x726 0x78ab 0x906b 0x726 0x7a12 0x903b 0x726 0x7b79 0x9021 0x726 0x7ce0 0x901a 0x726 0x7e47 0x900c 0x726 0x7fae 0x8ffa 0x739 0x8116 0x8fd8 0x75d 0x827d 0x8f82 0x793 0x83e4 0x8e54 0x773 0x854b 0x8c8e 0x768 0x86b2 0x8a38 0x79f 0x881a 0x8683 0x841 0x8981 0x814e 0x914 0x8ae8 0x7f94 0x68b>;
		battery0_profile_t2_num = <0x64>;
		battery0_profile_t2 = <0x00 0xaabe 0xc4e 0x167 0xaa03 0xc4e 0x2ce 0xa963 0xc6f 0x436 0xa8d5 0xca1 0x59d 0xa84c 0xcc5 0x704 0xa7c9 0xccb 0x86b 0xa74b 0xccb 0x9d2 0xa6d1 0xccc 0xb3a 0xa65e 0xcde 0xca1 0xa5e7 0xce4 0xe08 0xa56f 0xce4 0xf6f 0xa4fc 0xce4 0x10d6 0xa489 0xcf4 0x123d 0xa419 0xd05 0x13a5 0xa3ad 0xd15 0x150c 0xa33a 0xd03 0x1673 0xa2cc 0xd09 0x17da 0xa260 0xd1b 0x1941 0xa1f4 0xd2d 0x1aa9 0xa182 0xd2f 0x1c10 0xa113 0xd2f 0x1d77 0xa0a8 0xd33 0x1ede 0xa043 0xd57 0x2045 0x9fdf 0xd61 0x21ad 0x9f84 0xd6d 0x2314 0x9f3c 0xd91 0x247b 0x9ef3 0xdc7 0x25e2 0x9e8d 0xdde 0x2749 0x9e0a 0xdd1 0x28b1 0x9d5d 0xd89 0x2a18 0x9cb7 0xd4f 0x2b7f 0x9c23 0xd2f 0x2ce6 0x9ba9 0xd2f 0x2e4d 0x9b4c 0xd1d 0x2fb5 0x9af7 0xd16 0x311c 0x9aaa 0xd1a 0x3283 0x9a62 0xd2c 0x33ea 0x9a0e 0xd02 0x3551 0x99b1 0xccc 0x36b8 0x994d 0xc96 0x3820 0x98f0 0xc60 0x3987 0x9892 0xc2a 0x3aee 0x9837 0xbfe 0x3c55 0x97e1 0xbec 0x3dbc 0x9791 0xbcb 0x3f24 0x9749 0xbaf 0x408b 0x9708 0xb9f 0x41f2 0x96c7 0xb9f 0x4359 0x968c 0xb92 0x44c0 0x9652 0xb86 0x4628 0x9619 0xb86 0x478f 0x95e6 0xb86 0x48f6 0x95b7 0xb8f 0x4a5d 0x958c 0xb9f 0x4bc4 0x9561 0xb9f 0x4d2c 0x9536 0xb9f 0x4e93 0x950e 0xb8c 0x4ffa 0x94ea 0xb56 0x5161 0x94bf 0xb87 0x52c8 0x9498 0xba9 0x5430 0x9474 0xbbb 0x5597 0x9450 0xbcd 0x56fe 0x942c 0xbd1 0x5865 0x940b 0xbd8 0x59cc 0x93ee 0xbea 0x5b33 0x93ca 0xbd8 0x5c9b 0x93aa 0xbc6 0x5e02 0x9391 0xbc1 0x5f69 0x9382 0xbe5 0x60d0 0x9368 0xbea 0x6237 0x934e 0xbfa 0x639f 0x9338 0xc1d 0x6506 0x931b 0xc2f 0x666d 0x92fa 0xc1d 0x67d4 0x92d8 0xc0d 0x693b 0x92bb 0xc31 0x6aa3 0x9292 0xc45 0x6c0a 0x9267 0xc69 0x6d71 0x923a 0xc9b 0x6ed8 0x9201 0xcad 0x703f 0x91c2 0xccc 0x71a7 0x9181 0xcf5 0x730e 0x9141 0xd2b 0x7475 0x90f3 0xd50 0x75dc 0x90ab 0xd7e 0x7743 0x906f 0xdbb 0x78ab 0x9052 0xe15 0x7a12 0x903b 0xe99 0x7b79 0x9023 0xf3d 0x7ce0 0x9006 0x1003 0x7e47 0x8fcd 0x10fe 0x7fae 0x8f4a 0x11e4 0x8116 0x8e5d 0x12a8 0x827d 0x8c98 0x1326 0x83e4 0x8a00 0x1463 0x854b 0x86b8 0x1508 0x86b2 0x828a 0xddf 0x881a 0x8214 0xcb2 0x8981 0x8214 0xcb2 0x8ae8 0x8214 0xcb2>;
		battery0_profile_t3_num = <0x64>;
		battery0_profile_t3 = <0x00 0xaa82 0x11e4 0x167 0xa971 0x11e0 0x2ce 0xa864 0x12ae 0x436 0xa769 0x13f4 0x59d 0xa69f 0x1502 0x704 0xa5ee 0x15c5 0x86b 0xa54b 0x1652 0x9d2 0xa4b5 0x16ac 0xb3a 0xa434 0x1718 0xca1 0xa3b2 0x1755 0xe08 0xa335 0x177e 0xf6f 0xa2c2 0x17b4 0x10d6 0xa248 0x17bb 0x123d 0xa1d2 0x17c3 0x13a5 0xa15f 0x17d3 0x150c 0xa0ec 0x17c1 0x1673 0xa083 0x17c7 0x17da 0xa020 0x17d9 0x1941 0x9fc3 0x17eb 0x1aa9 0x9f6c 0x181e 0x1c10 0x9f07 0x1841 0x1d77 0x9e8f 0x1848 0x1ede 0x9ded 0x17ff 0x2045 0x9d49 0x17a9 0x21ad 0x9ca9 0x1763 0x2314 0x9c12 0x173f 0x247b 0x9b97 0x170a 0x25e2 0x9b26 0x16e9 0x2749 0x9abc 0x16da 0x28b1 0x9a5f 0x16da 0x2a18 0x9a07 0x16cc 0x2b7f 0x99ae 0x16ab 0x2ce6 0x9951 0x1676 0x2e4d 0x98f4 0x1664 0x2fb5 0x989b 0x1647 0x311c 0x9846 0x1623 0x3283 0x97f7 0x15ff 0x33ea 0x97a8 0x15db 0x3551 0x975c 0x15bf 0x36b8 0x9715 0x15ac 0x3820 0x96dc 0x1588 0x3987 0x969c 0x1588 0x3aee 0x965f 0x159a 0x3c55 0x962d 0x15ac 0x3dbc 0x95f4 0x15ce 0x3f24 0x95be 0x15e0 0x408b 0x958d 0x15e6 0x41f2 0x9562 0x161c 0x4359 0x9537 0x1611 0x44c0 0x950c 0x15f9 0x4628 0x94e0 0x15f9 0x478f 0x94bc 0x161b 0x48f6 0x9494 0x1635 0x4a5d 0x946b 0x1644 0x4bc4 0x944f 0x1644 0x4d2c 0x942c 0x166d 0x4e93 0x940e 0x16a3 0x4ffa 0x93f8 0x16d9 0x5161 0x93dc 0x16da 0x52c8 0x93c3 0x16e5 0x5430 0x93ac 0x16f3 0x5597 0x9390 0x16f3 0x56fe 0x9373 0x171e 0x5865 0x9356 0x1745 0x59cc 0x9339 0x1758 0x5b33 0x931d 0x178e 0x5c9b 0x92fb 0x17db 0x5e02 0x92d6 0x182c 0x5f69 0x92ab 0x1862 0x60d0 0x927f 0x18b6 0x6237 0x9251 0x1910 0x639f 0x921e 0x196a 0x6506 0x91e5 0x19c3 0x666d 0x91ab 0x1a29 0x67d4 0x9170 0x1a95 0x693b 0x912f 0x1b01 0x6aa3 0x90f5 0x1b9c 0x6c0a 0x90bf 0x1c3e 0x6d71 0x908e 0x1ce3 0x6ed8 0x9062 0x1da9 0x703f 0x9037 0x1e95 0x71a7 0x9005 0x1fa1 0x730e 0x8fc5 0x20d3 0x7475 0x8f63 0x2247 0x75dc 0x8eb9 0x23ad 0x7743 0x8db6 0x24ee 0x78ab 0x8c06 0x258e 0x7a12 0x89d6 0x2022 0x7b79 0x86e4 0x18c2 0x7ce0 0x862e 0x170c 0x7e47 0x862e 0x170c 0x7fae 0x862e 0x170c 0x8116 0x862e 0x170c 0x827d 0x862e 0x170c 0x83e4 0x862e 0x170c 0x854b 0x862e 0x170c 0x86b2 0x862e 0x170c 0x881a 0x862e 0x170c 0x8981 0x862e 0x170c 0x8ae8 0x862e 0x170c>;
		battery0_profile_t4_num = <0x64>;
		battery0_profile_t4 = <0x00 0xa9b0 0x22f6 0x167 0xa8fc 0x22f6 0x2ce 0xa852 0x2379 0x436 0xa7ae 0x242e 0x59d 0xa710 0x2464 0x704 0xa67e 0x248b 0x86b 0xa5ee 0x248f 0x9d2 0xa55f 0x246d 0xb3a 0xa4d6 0x246d 0xca1 0xa44e 0x2461 0xe08 0xa3c9 0x2466 0xf6f 0xa34f 0x24ae 0x10d6 0xa2c2 0x24b8 0x123d 0xa225 0x24c0 0x13a5 0xa175 0x24d8 0x150c 0xa0a5 0x2532 0x1673 0x9fb7 0x25d6 0x17da 0x9ebe 0x26eb 0x1941 0x9dc9 0x28be 0x1aa9 0x9d09 0x2a40 0x1c10 0x9c59 0x2b66 0x1d77 0x9bb7 0x2c3c 0x1ede 0x9b27 0x2d01 0x2045 0x9aa7 0x2d92 0x21ad 0x9a32 0x2df8 0x2314 0x99c6 0x2e2e 0x247b 0x995f 0x2e42 0x25e2 0x98fa 0x2e4a 0x2749 0x9896 0x2e4d 0x28b1 0x9839 0x2e5f 0x2a18 0x97e1 0x2e71 0x2b7f 0x978b 0x2e83 0x2ce6 0x9735 0x2e95 0x2e4d 0x96ed 0x2e95 0x2fb5 0x96aa 0x2e7f 0x311c 0x966b 0x2e6b 0x3283 0x9631 0x2e8f 0x33ea 0x95fe 0x2ea4 0x3551 0x95cc 0x2eae 0x36b8 0x959a 0x2eae 0x3820 0x9576 0x2eae 0x3987 0x9552 0x2eba 0x3aee 0x952e 0x2ed1 0x3c55 0x950a 0x2ef5 0x3dbc 0x94e7 0x2f38 0x3f24 0x94c6 0x2f6e 0x408b 0x94aa 0x2f96 0x41f2 0x9494 0x2fdd 0x4359 0x9475 0x3025 0x44c0 0x9453 0x3062 0x4628 0x9436 0x3086 0x478f 0x941a 0x30ec 0x48f6 0x93f5 0x3132 0x4a5d 0x93cb 0x315a 0x4bc4 0x93a7 0x31a2 0x4d2c 0x937e 0x3205 0x4e93 0x9353 0x3296 0x4ffa 0x9328 0x336d 0x5161 0x92ef 0x33bc 0x52c8 0x92ba 0x33ef 0x5430 0x9285 0x341c 0x5597 0x9244 0x3476 0x56fe 0x9210 0x348a 0x5865 0x91d6 0x3416 0x59cc 0x919c 0x3386 0x5b33 0x915d 0x32e9 0x5c9b 0x9123 0x3258 0x5e02 0x90df 0x31ae 0x5f69 0x90a9 0x313f 0x60d0 0x9078 0x30b1 0x6237 0x9051 0x3064 0x639f 0x901a 0x2fda 0x6506 0x8ffc 0x2f8f 0x666d 0x8ffc 0x2f8f 0x67d4 0x8ffc 0x2f8f 0x693b 0x8ffc 0x2f8f 0x6aa3 0x8ffc 0x2f8f 0x6c0a 0x8ffc 0x2f8f 0x6d71 0x8ffc 0x2f8f 0x6ed8 0x8ffc 0x2f8f 0x703f 0x8ffc 0x2f8f 0x71a7 0x8ffc 0x2f8f 0x730e 0x8ffc 0x2f8f 0x7475 0x8ffc 0x2f8f 0x75dc 0x8ffc 0x2f8f 0x7743 0x8ffc 0x2f8f 0x78ab 0x8ffc 0x2f8f 0x7a12 0x8ffc 0x2f8f 0x7b79 0x8ffc 0x2f8f 0x7ce0 0x8ffc 0x2f8f 0x7e47 0x8ffc 0x2f8f 0x7fae 0x8ffc 0x2f8f 0x8116 0x8ffc 0x2f8f 0x827d 0x8ffc 0x2f8f 0x83e4 0x8ffc 0x2f8f 0x854b 0x8ffc 0x2f8f 0x86b2 0x8ffc 0x2f8f 0x881a 0x8ffc 0x2f8f 0x8981 0x8ffc 0x2f8f 0x8ae8 0x8ffc 0x2f8f>;
		battery1_profile_t0_num = <0x64>;
		battery1_profile_t0 = <0x00 0xab68 0x47e 0x171 0xaab7 0x459 0x2e2 0xaa19 0x440 0x454 0xa989 0x433 0x5c5 0xa904 0x433 0x736 0xa87f 0x422 0x8a7 0xa803 0x425 0xa18 0xa78b 0x42f 0xb8a 0xa70e 0x41c 0xcfb 0xa697 0x42a 0xe6c 0xa61d 0x429 0xfdd 0xa5a2 0x41d 0x114e 0xa533 0x430 0x12bf 0xa4be 0x433 0x1431 0xa448 0x433 0x15a2 0xa2ef 0x433 0x1713 0x99d1 0x433 0x1884 0x9dad 0x44c 0x19f5 0xa27c 0x44c 0x1b67 0xa20e 0x44c 0x1cd8 0xa19f 0x44c 0x1e49 0xa130 0x459 0x1fba 0xa0c1 0x465 0x212b 0xa053 0x465 0x229d 0x9fe4 0x453 0x240e 0x9f78 0x458 0x257f 0x9f0f 0x465 0x26f0 0x9ea8 0x465 0x2861 0x9e48 0x476 0x29d3 0x9de8 0x489 0x2b44 0x9d86 0x493 0x2cb5 0x9d1f 0x480 0x2e26 0x9cc4 0x48e 0x2f97 0x9c6c 0x4a1 0x3109 0x9c13 0x4b0 0x327a 0x9bba 0x4b0 0x33eb 0x9b62 0x4bf 0x355c 0x9b0d 0x4d2 0x36cd 0x9abb 0x4e4 0x383e 0x9a6a 0x4f6 0x39b0 0x9a13 0x509 0x3b21 0x99be 0x51b 0x3c92 0x996b 0x52b 0x3e03 0x98fc 0x506 0x3f74 0x9883 0x4c8 0x40e6 0x9808 0x47e 0x4257 0x9792 0x434 0x43c8 0x9740 0x433 0x4539 0x96f8 0x433 0x46aa 0x96b8 0x433 0x481c 0x967d 0x433 0x498d 0x9642 0x422 0x4afe 0x960b 0x424 0x4c6f 0x95d7 0x433 0x4de0 0x95a4 0x433 0x4f52 0x9576 0x433 0x50c3 0x954a 0x43c 0x5234 0x951f 0x44c 0x53a5 0x94fa 0x44c 0x5516 0x94cf 0x44c 0x5688 0x94a6 0x454 0x57f9 0x9481 0x465 0x596a 0x945c 0x465 0x5adb 0x943c 0x472 0x5c4c 0x941f 0x485 0x5dbd 0x9401 0x497 0x5f2f 0x93e4 0x4aa 0x60a0 0x93c6 0x4b0 0x6211 0x93a6 0x4b0 0x6382 0x9382 0x4b0 0x64f3 0x9356 0x48d 0x6665 0x931c 0x468 0x67d6 0x92d8 0x447 0x6947 0x928e 0x435 0x6ab8 0x925e 0x444 0x6c29 0x9231 0x44c 0x6d9b 0x9205 0x44c 0x6f0c 0x91d8 0x44c 0x707d 0x91ac 0x43c 0x71ee 0x9187 0x446 0x735f 0x9168 0x465 0x74d1 0x9144 0x465 0x7642 0x910d 0x456 0x77b3 0x90d2 0x44c 0x7924 0x9097 0x44c 0x7a95 0x905c 0x44c 0x7c07 0x9016 0x44c 0x7d78 0x8fcf 0x43e 0x7ee9 0x8f8e 0x41b 0x805a 0x8f86 0x440 0x81cb 0x8f7f 0x465 0x833c 0x8f73 0x48a 0x84ae 0x8f5d 0x4af 0x861f 0x8f2a 0x4e5 0x8790 0x8e63 0x4b8 0x8901 0x8d03 0x46e 0x8a72 0x8aff 0x493 0x8be4 0x880b 0x4d9 0x8d55 0x8394 0x57b 0x8ec6 0x7ea4 0x433>;
		battery1_profile_t1_num = <0x64>;
		battery1_profile_t1 = <0x00 0xab22 0x47e 0x171 0xaa71 0x5a5 0x2e2 0xa9dc 0x626 0x454 0xa957 0x63b 0x5c5 0xa8d2 0x628 0x736 0xa854 0x616 0x8a7 0xa7d7 0x60e 0xa18 0xa75b 0x612 0xb8a 0xa6e5 0x625 0xcfb 0xa66f 0x627 0xe6c 0xa5f9 0x627 0xfdd 0xa581 0x624 0x114e 0xa504 0x611 0x12bf 0xa492 0x61d 0x1431 0xa420 0x627 0x15a2 0xa3ab 0x627 0x1713 0xa33c 0x627 0x1884 0xa2c8 0x627 0x19f5 0xa254 0x62e 0x1b67 0xa1e6 0x640 0x1cd8 0xa177 0x640 0x1e49 0xa108 0x640 0x1fba 0xa099 0x646 0x212b 0xa02b 0x659 0x229d 0x9fc3 0x66b 0x240e 0x9f5a 0x672 0x257f 0x9efc 0x682 0x26f0 0x9eba 0x6ba 0x2861 0x9e63 0x6ce 0x29d3 0x9de7 0x6cb 0x2b44 0x9d54 0x6b9 0x2cb5 0x9cc0 0x6a6 0x2e26 0x9c4d 0x6b4 0x2f97 0x9bf5 0x6d0 0x3109 0x9bb5 0x6f5 0x327a 0x9b82 0x71a 0x33eb 0x9b3c 0x721 0x355c 0x9aef 0x721 0x36cd 0x9a9d 0x721 0x383e 0x9a44 0x721 0x39b0 0x99e6 0x721 0x3b21 0x9980 0x70b 0x3c92 0x9911 0x6d3 0x3e03 0x989b 0x689 0x3f74 0x982a 0x63f 0x40e6 0x97c2 0x608 0x4257 0x976a 0x5f5 0x43c8 0x9718 0x5d1 0x4539 0x96d5 0x5c3 0x46aa 0x969a 0x5c3 0x481c 0x965f 0x5c3 0x498d 0x962b 0x5c3 0x4afe 0x95f7 0x5c3 0x4c6f 0x95c3 0x5c3 0x4de0 0x9590 0x5c3 0x4f52 0x9562 0x5c3 0x50c3 0x953a 0x5cc 0x5234 0x9514 0x5dc 0x53a5 0x94e7 0x5dc 0x5516 0x94c1 0x5dc 0x5688 0x949f 0x5e4 0x57f9 0x9481 0x5f5 0x596a 0x945c 0x5f5 0x5adb 0x943c 0x602 0x5c4c 0x941f 0x60e 0x5dbd 0x9401 0x60e 0x5f2f 0x93e4 0x621 0x60a0 0x93c6 0x627 0x6211 0x93a9 0x627 0x6382 0x938b 0x627 0x64f3 0x936e 0x615 0x6665 0x934c 0x603 0x67d6 0x9327 0x5f0 0x6947 0x9302 0x5de 0x6ab8 0x92e3 0x5ed 0x6c29 0x92bd 0x5e0 0x6d9b 0x9292 0x5c7 0x6f0c 0x926d 0x5d9 0x707d 0x9248 0x5dc 0x71ee 0x9227 0x5e5 0x735f 0x9206 0x5f5 0x74d1 0x91d3 0x5f5 0x7642 0x9199 0x604 0x77b3 0x915e 0x60e 0x7924 0x9123 0x610 0x7a95 0x90e8 0x622 0x7c07 0x9097 0x627 0x7d78 0x904c 0x627 0x7ee9 0x901a 0x628 0x805a 0x900b 0x64d 0x81cb 0x8ffc 0x67e 0x833c 0x8feb 0x6c1 0x84ae 0x8fd5 0x71d 0x861f 0x8f86 0x77a 0x8790 0x8e8f 0x793 0x8901 0x8ced 0x7a1 0x8a72 0x8a90 0x810 0x8be4 0x86fa 0x903 0x8d55 0x81f1 0x98c 0x8ec6 0x7f30 0x578>;
		battery1_profile_t2_num = <0x64>;
		battery1_profile_t2 = <0x00 0xaa96 0x4e2 0x171 0xa9b1 0xb5f 0x2e2 0xa8f2 0xdd0 0x454 0xa84f 0xdfc 0x5c5 0xa7bb 0xe0f 0x736 0xa735 0xe21 0x8a7 0xa6b5 0xe34 0xa18 0xa637 0xe3e 0xb8a 0xa5ba 0xe2b 0xcfb 0xa543 0xe39 0xe6c 0xa4cd 0xe42 0xfdd 0xa456 0xe42 0x114e 0xa3e0 0xe42 0x12bf 0xa370 0xe42 0x1431 0xa2fe 0xe42 0x15a2 0xa289 0xe44 0x1713 0xa21a 0xe56 0x1884 0xa1ab 0xe5b 0x19f5 0xa13c 0xe5b 0x1b67 0xa0ce 0xe5b 0x1cd8 0xa05f 0xe5b 0x1e49 0x9fff 0xe74 0x1fba 0x9fa9 0xe99 0x212b 0x9f58 0xebe 0x229d 0x9eff 0xf07 0x240e 0x9e8a 0xf17 0x257f 0x9dfa 0xefa 0x26f0 0x9d58 0xec2 0x2861 0x9cc3 0xe9c 0x29d3 0x9c52 0xeb8 0x2b44 0x9bf3 0xee0 0x2cb5 0x9b7c 0xe96 0x2e26 0x9b2d 0xebe 0x2f97 0x9ae3 0xee2 0x3109 0x9a99 0xef4 0x327a 0x9a50 0xf07 0x33eb 0x99fa 0xefb 0x355c 0x999e 0xed7 0x36cd 0x993d 0xea2 0x383e 0x98d6 0xe7d 0x39b0 0x9874 0xe58 0x3b21 0x9814 0xe3b 0x3c92 0x97b4 0xe29 0x3e03 0x975c 0xe29 0x3f74 0x970d 0xe1c 0x40e6 0x96c6 0xe10 0x4257 0x9683 0xe10 0x43c8 0x9648 0xdec 0x4539 0x960d 0xdea 0x46aa 0x95d4 0xdf7 0x481c 0x95a0 0xdf7 0x498d 0x9573 0xe19 0x4afe 0x9547 0xe33 0x4c6f 0x951b 0xe46 0x4de0 0x94ee 0xe58 0x4f52 0x94c8 0xe7b 0x50c3 0x94a4 0xe96 0x5234 0x947f 0xea9 0x53a5 0x945a 0xebb 0x5516 0x943b 0xedc 0x5688 0x9420 0xef9 0x57f9 0x940a 0xf0d 0x596a 0x93f4 0xf32 0x5adb 0x93de 0xf57 0x5c4c 0x93ca 0xf7c 0x5dbd 0x93bc 0xfa1 0x5f2f 0x93ad 0xfd9 0x60a0 0x9399 0x1004 0x6211 0x9385 0x1034 0x6382 0x9377 0x107e 0x64f3 0x9361 0x10b6 0x6665 0x9346 0x10f9 0x67d6 0x9329 0x113e 0x6947 0x930b 0x1175 0x6ab8 0x92e6 0x11cf 0x6c29 0x92c1 0x122c 0x6d9b 0x929b 0x128d 0x6f0c 0x926e 0x12fb 0x707d 0x923c 0x138a 0x71ee 0x9204 0x141d 0x735f 0x91c8 0x14b7 0x74d1 0x9186 0x156f 0x7642 0x9143 0x1645 0x77b3 0x90fa 0x1723 0x7924 0x90aa 0x1803 0x7a95 0x9060 0x1906 0x7c07 0x902c 0x1a4c 0x7d78 0x9005 0x1bb2 0x7ee9 0x8fe7 0x1d26 0x805a 0x8fc2 0x1f18 0x81cb 0x8f85 0x2149 0x833c 0x8f11 0x23a9 0x84ae 0x8e42 0x262f 0x861f 0x8cc3 0x2757 0x8790 0x8a91 0x21e9 0x8901 0x877a 0x1a4a 0x8a72 0x8444 0x125c 0x8be4 0x8444 0x125c 0x8d55 0x8444 0x125c 0x8ec6 0x8444 0x125c>;
		battery1_profile_t3_num = <0x64>;
		battery1_profile_t3 = <0x00 0xaa3c 0x726 0x171 0xa906 0x1557 0x2e2 0xa7f1 0x1b35 0x454 0xa704 0x1c5b 0x5c5 0xa64c 0x1d26 0x736 0xa5a8 0x1d78 0x8a7 0xa512 0x1da2 0xa18 0xa488 0x1db0 0xb8a 0xa403 0x1db0 0xcfb 0xa384 0x1da0 0xe6c 0xa307 0x1d8d 0xfdd 0xa28a 0x1d7b 0x114e 0xa214 0x1d68 0x12bf 0xa198 0x1d47 0x1431 0xa121 0x1d2b 0x15a2 0xa0b4 0x1d1a 0x1713 0xa054 0x1d1a 0x1884 0x9ff4 0x1d28 0x19f5 0x9f8e 0x1d2c 0x1b67 0x9f1e 0x1d18 0x1cd8 0x9e92 0x1ce0 0x1e49 0x9df7 0x1c90 0x1fba 0x9d57 0x1c33 0x212b 0x9cbc 0x1bd7 0x229d 0x9c3d 0x1bb1 0x240e 0x9bc8 0x1b97 0x257f 0x9b5e 0x1b8f 0x26f0 0x9b05 0x1ba2 0x2861 0x9ab4 0x1bb4 0x29d3 0x9a85 0x1c13 0x2b44 0x9a52 0x1c48 0x2cb5 0x99be 0x1b46 0x2e26 0x9951 0x1b26 0x2f97 0x98ea 0x1b13 0x3109 0x9884 0x1aeb 0x327a 0x9824 0x1ab3 0x33eb 0x97d0 0x1a9a 0x355c 0x977f 0x1a90 0x36cd 0x972f 0x1a90 0x383e 0x96ec 0x1a90 0x39b0 0x96aa 0x1a90 0x3b21 0x966b 0x1a90 0x3c92 0x9630 0x1a91 0x3e03 0x95fc 0x1aa3 0x3f74 0x95c8 0x1ab6 0x40e6 0x9597 0x1ac8 0x4257 0x956b 0x1adb 0x43c8 0x9537 0x1aed 0x4539 0x950d 0x1b00 0x46aa 0x94e8 0x1b17 0x481c 0x94c3 0x1b3c 0x498d 0x94a5 0x1b61 0x4afe 0x9487 0x1b86 0x4c6f 0x946b 0x1bb2 0x4de0 0x9455 0x1bfc 0x4f52 0x9439 0x1c17 0x50c3 0x941f 0x1c3c 0x5234 0x940a 0x1c78 0x53a5 0x93fb 0x1cd5 0x5516 0x93e1 0x1d14 0x5688 0x93ca 0x1d5b 0x57f9 0x93ba 0x1db8 0x596a 0x93a4 0x1e14 0x5adb 0x9388 0x1e70 0x5c4c 0x936b 0x1ecd 0x5dbd 0x934d 0x1f29 0x5f2f 0x9328 0x1f98 0x60a0 0x9303 0x2013 0x6211 0x92dc 0x209a 0x6382 0x92b0 0x212e 0x64f3 0x9284 0x21e5 0x6665 0x924e 0x2292 0x67d6 0x9211 0x2342 0x6947 0x91cf 0x240d 0x6ab8 0x918b 0x24ec 0x6c29 0x9148 0x25eb 0x6d9b 0x9107 0x2704 0x6f0c 0x90cc 0x282b 0x707d 0x9091 0x2953 0x71ee 0x905a 0x2a96 0x735f 0x9027 0x2bfa 0x74d1 0x8ffb 0x2d7e 0x7642 0x8fbc 0x2e7b 0x77b3 0x8f69 0x2e06 0x7924 0x8ee7 0x2cc2 0x7a95 0x8de4 0x2a46 0x7c07 0x8c16 0x25c2 0x7d78 0x8970 0x1f21 0x7ee9 0x882c 0x1c07 0x805a 0x882c 0x1c07 0x81cb 0x882c 0x1c07 0x833c 0x882c 0x1c07 0x84ae 0x882c 0x1c07 0x861f 0x882c 0x1c07 0x8790 0x882c 0x1c07 0x8901 0x882c 0x1c07 0x8a72 0x882c 0x1c07 0x8be4 0x882c 0x1c07 0x8d55 0x882c 0x1c07 0x8ec6 0x882c 0x1c07>;
		battery1_profile_t4_num = <0x64>;
		battery1_profile_t4 = <0x00 0xa9c4 0xbb8 0x171 0xa8d8 0x1ec1 0x2e2 0xa7eb 0x261b 0x454 0xa701 0x26eb 0x5c5 0xa61c 0x276c 0x736 0xa54c 0x27fe 0x8a7 0xa48f 0x289d 0xa18 0xa3e4 0x2936 0xb8a 0xa351 0x29a5 0xcfb 0xa2bd 0x29a3 0xe6c 0xa231 0x297d 0xfdd 0xa1ae 0x294f 0x114e 0xa138 0x294f 0x12bf 0xa0c8 0x2913 0x1431 0xa059 0x28e3 0x15a2 0x9fe8 0x28ca 0x1713 0x9f63 0x2881 0x1884 0x9ec3 0x27ff 0x19f5 0x9e13 0x2765 0x1b67 0x9d5c 0x26c0 0x1cd8 0x9cc1 0x263f 0x1e49 0x9c35 0x25e3 0x1fba 0x9bb7 0x25a6 0x212b 0x9b49 0x2581 0x229d 0x9ae1 0x255c 0x240e 0x9a82 0x2542 0x257f 0x9a26 0x252a 0x26f0 0x99c6 0x2505 0x2861 0x996d 0x24e0 0x29d3 0x992e 0x24fc 0x2b44 0x98f1 0x250a 0x2cb5 0x987a 0x2452 0x2e26 0x9818 0x241b 0x2f97 0x97bf 0x23f6 0x3109 0x9771 0x23d7 0x327a 0x972e 0x23d7 0x33eb 0x96e6 0x23c8 0x355c 0x96a3 0x23cf 0x36cd 0x9668 0x23ee 0x383e 0x9635 0x23dc 0x39b0 0x95fc 0x23d7 0x3b21 0x95c6 0x23d7 0x3c92 0x959a 0x23d8 0x3e03 0x956e 0x23ea 0x3f74 0x9547 0x2409 0x40e6 0x951f 0x2422 0x4257 0x94f3 0x2422 0x43c8 0x94d5 0x2458 0x4539 0x94b8 0x2461 0x46aa 0x949c 0x2463 0x481c 0x9486 0x249a 0x498d 0x9469 0x24d2 0x4afe 0x9450 0x24ff 0x4c6f 0x9439 0x252b 0x4de0 0x9423 0x2575 0x4f52 0x9407 0x25bf 0x50c3 0x93ed 0x2609 0x5234 0x93d6 0x265e 0x53a5 0x93b8 0x26f1 0x5516 0x9395 0x2759 0x5688 0x9373 0x27c6 0x57f9 0x9354 0x2844 0x596a 0x9328 0x28a0 0x5adb 0x92fc 0x2917 0x5c4c 0x92cf 0x2998 0x5dbd 0x92a3 0x2a1a 0x5f2f 0x926f 0x2ac1 0x60a0 0x9237 0x2b5a 0x6211 0x91fc 0x2bfa 0x6382 0x91c1 0x2cb2 0x64f3 0x9185 0x2d7c 0x6665 0x9146 0x2e47 0x67d6 0x9103 0x2f20 0x6947 0x90c1 0x3023 0x6ab8 0x9084 0x30ae 0x6c29 0x9043 0x3026 0x6d9b 0x900b 0x2f9b 0x6f0c 0x8fd3 0x2f28 0x707d 0x8f82 0x2e5e 0x71ee 0x8efa 0x2d0a 0x735f 0x8de5 0x2a68 0x74d1 0x8be1 0x2565 0x7642 0x8ba6 0x24ea 0x77b3 0x8ba6 0x24ea 0x7924 0x8ba6 0x24ea 0x7a95 0x8ba6 0x24ea 0x7c07 0x8ba6 0x24ea 0x7d78 0x8ba6 0x24ea 0x7ee9 0x8ba6 0x24ea 0x805a 0x8ba6 0x24ea 0x81cb 0x8ba6 0x24ea 0x833c 0x8ba6 0x24ea 0x84ae 0x8ba6 0x24ea 0x861f 0x8ba6 0x24ea 0x8790 0x8ba6 0x24ea 0x8901 0x8ba6 0x24ea 0x8a72 0x8ba6 0x24ea 0x8be4 0x8ba6 0x24ea 0x8d55 0x8ba6 0x24ea 0x8ec6 0x8ba6 0x24ea>;
		linux,phandle = <0x59>;
		phandle = <0x59>;
	};

	mt_charger {
		compatible = "mediatek,mt-charger";
		linux,phandle = <0x5a>;
		phandle = <0x5a>;
	};

	charger {
		compatible = "mediatek,charger";
		algorithm_name = "SwitchCharging";
		enable_pe_plus;
		enable_pe_2;
		enable_pe_3;
		battery_cv = <0x426030>;
		max_charger_voltage = <0x632ea0>;
		usb_charger_current_suspend = <0x00>;
		usb_charger_current_unconfigured = <0x11170>;
		usb_charger_current_configured = <0x7a120>;
		usb_charger_current = <0x7a120>;
		ac_charger_current = <0x1f47d0>;
		ac_charger_input_current = <0x30d400>;
		non_std_ac_charger_current = <0x7a120>;
		charging_host_charger_current = <0x7a120>;
		apple_1_0a_charger_current = <0x9eb10>;
		apple_2_1a_charger_current = "", "\f5";
		ta_ac_charger_current = <0x2dc6c0>;
		jeita_temp_above_t4_cv_voltage = <0x40b280>;
		jeita_temp_t3_to_t4_cv_voltage = <0x40b280>;
		jeita_temp_t2_to_t3_cv_voltage = <0x423920>;
		jeita_temp_t1_to_t2_cv_voltage = <0x40b280>;
		jeita_temp_t0_to_t1_cv_voltage = <0x3da540>;
		jeita_temp_below_t0_cv_voltage = <0x3da540>;
		temp_t4_threshold = <0x32>;
		temp_t4_thres_minus_x_degree = <0x2f>;
		temp_t3_threshold = <0x2d>;
		temp_t3_thres_minus_x_degree = <0x27>;
		temp_t2_threshold = <0x0a>;
		temp_t2_thres_plus_x_degree = <0x10>;
		temp_t1_threshold = <0x00>;
		temp_t1_thres_plus_x_degree = <0x06>;
		temp_t0_threshold = <0x00>;
		temp_t0_thres_plus_x_degree = <0x00>;
		temp_neg_10_threshold = <0x00>;
		enable_min_charge_temperature;
		min_charge_temperature = <0x00>;
		min_charge_temperature_plus_x_degree = <0x06>;
		max_charge_temperature = <0x3a>;
		max_charge_temperature_minus_x_degree = <0x37>;
		pe20_ichg_level_threshold = <0x3e8>;
		ta_start_battery_soc = <0x00>;
		ta_stop_battery_soc = <0x55>;
		chg1_ta_ac_charger_current = <0x16e360>;
		chg2_ta_ac_charger_current = <0x16e360>;
		cable_imp_threshold = <0x2bb>;
		vbat_cable_imp_threshold = <0xf3c>;
		bif_threshold1 = <0x40d990>;
		bif_threshold2 = <0x419ce0>;
		bif_cv_under_threshold2 = <0x43e6d0>;
		enable_sw_safety_timer;
		max_charging_time = <0xa8c0>;
		recharge_offset = <0x249f0>;
		topoff_voltage = <0x401640>;
		chg_full_current = <0x249f0>;
		linux,phandle = <0x5b>;
		phandle = <0x5b>;
	};

	pmic_clock_buffer_ctrl {
		compatible = "mediatek,pmic_clock_buffer";
		mediatek,clkbuf-quantity = <0x07>;
		mediatek,clkbuf-config = <0x02 0x01 0x01 0x02 0x00 0x00 0x00>;
		mediatek,clkbuf-driving-current = <0xffffffff 0xffffffff 0xffffffff 0xffffffff 0xffffffff 0xffffffff 0xffffffff>;
		linux,phandle = <0x5c>;
		phandle = <0x5c>;
	};

	consys@18070000 {
		compatible = "mediatek,mt6739-consys";
		#address-cells = <0x02>;
		#size-cells = <0x02>;
		reg = <0x00 0x18070000 0x00 0x200 0x00 0x10007000 0x00 0x100 0x00 0x10000000 0x00 0x2000 0x00 0x10006000 0x00 0x1000>;
		interrupts = <0x00 0xe9 0x08 0x00 0xeb 0x02>;
		clocks = <0x1a 0x03>;
		clock-names = "conn";
		linux,phandle = <0x5d>;
		phandle = <0x5d>;
	};

	goodix_fp {
		compatible = "mediatek,goodix-fp";
		linux,phandle = <0x5e>;
		phandle = <0x5e>;
	};

	hct_finger {
		compatible = "mediatek,hct_finger";
		linux,phandle = <0x5f>;
		phandle = <0x5f>;
	};

	fpc_finger {
		compatible = "mediatek,fpc_finger";
		linux,phandle = <0x60>;
		phandle = <0x60>;
	};

	sunwave_fp {
		compatible = "mediatek,sunwave_fp";
		linux,phandle = <0x61>;
		phandle = <0x61>;
	};

	fingerprint {
		compatible = "mediatek, fingerprint-eint";
		linux,phandle = <0x62>;
		phandle = <0x62>;
	};

	fpsensor_finger {
		compatible = "mediatek,fingerprint";
		linux,phandle = <0x63>;
		phandle = <0x63>;
	};

	ptt_key {
		compatible = "mediatek,key-ptt";
		linux,phandle = <0x64>;
		phandle = <0x64>;
	};

	soc_key {
		compatible = "mediatek,key-soc";
		linux,phandle = <0x65>;
		phandle = <0x65>;
	};

	mdr_drv {
		compatible = "mediatek, mdr_driver";
		linux,phandle = <0x66>;
		phandle = <0x66>;
	};

	hall_driver {
		compatible = "mediatek, hall_driver";
		linux,phandle = <0x67>;
		phandle = <0x67>;
	};

	halleint {
		compatible = "mediatek, HALL-eint";
		linux,phandle = <0x68>;
		phandle = <0x68>;
	};

	gps {
		compatible = "mediatek,gps";
	};

	als_ps@0 {
		compatible = "mediatek,als_ps";
		linux,phandle = <0x69>;
		phandle = <0x69>;
	};

	gse_1 {
		linux,phandle = <0x6a>;
		phandle = <0x6a>;
	};

	mse {
		linux,phandle = <0x6b>;
		phandle = <0x6b>;
	};

	gyro {
		compatible = "mediatek,gyroscope";
		linux,phandle = <0x6c>;
		phandle = <0x6c>;
	};

	smart_pa {
		compatible = "mediatek,mtksmartpa";
		linux,phandle = <0x6d>;
		phandle = <0x6d>;
	};

	mrdump_ext_rst {
		compatible = "mediatek, mrdump_ext_rst-eint";
		source = "EINT";
		mode = "IRQ";
		status = "okay";
		linux,phandle = <0x6e>;
		phandle = <0x6e>;
	};

	msdc1_ins {
		linux,phandle = <0x6f>;
		phandle = <0x6f>;
	};

	chr_stat {
		linux,phandle = <0x70>;
		phandle = <0x70>;
	};

	rt9465_slave_chr {
		linux,phandle = <0x71>;
		phandle = <0x71>;
	};

	dsi_te {
		compatible = "mediatek, dsi_te-eint";
		status = "disabled";
		linux,phandle = <0x72>;
		phandle = <0x72>;
	};

	kd_camera_hw1@15008000 {
		compatible = "mediatek,camera_hw";
		reg = <0x00 0x15008000 0x00 0x1000>;
		clocks = <0x24 0x2e 0x24 0x41 0x25 0x24 0x11 0x24 0x1a 0x24 0x10 0x24 0x1b 0x24 0x12 0x24 0x13 0x24 0x3f 0x24 0x37>;
		clock-names = "CLK_TOP_CAMTG_SEL", "CLK_TOP_CAMTG2_SEL", "CLK_TOP_CLK26M", "CLK_TOP_UNIVPLL_48M_D2", "CLK_TOP_UNIVPLL2_D8", "CLK_TOP_UNIVPLL_D26", "CLK_TOP_UNIVPLL2_D32", "CLK_TOP_UNIVPLL_48M_D4", "CLK_TOP_UNIVPLL_48M_D8", "CLK_TOP_SENINF_SEL", "CLK_TOP_SCAM_SEL";
		linux,phandle = <0x73>;
		phandle = <0x73>;
	};

	otg_iddig {
		compatible = "mediatek,usb_iddig_bi_eint";
		linux,phandle = <0x74>;
		phandle = <0x74>;
	};

	nfc {
		compatible = "mediatek,nfc-gpio-v2";
		gpio-rst = <0x07>;
		gpio-rst-std = <0x2e 0x07 0x00>;
		gpio-irq = <0x0e>;
		gpio-irq-std = <0x2e 0x0e 0x00>;
		linux,phandle = <0x75>;
		phandle = <0x75>;
	};

	irq_nfc {
		compatible = "mediatek,irq_nfc-eint";
		linux,phandle = <0x76>;
		phandle = <0x76>;
	};

	md1_sim1_hot_plug_eint {
		linux,phandle = <0x77>;
		phandle = <0x77>;
	};

	md1_sim2_hot_plug_eint {
		linux,phandle = <0x78>;
		phandle = <0x78>;
	};

	irtx_pwm {
		compatible = "mediatek,irtx-pwm";
		pwm_ch = <0x01>;
		pwm_data_invert = <0x00>;
		linux,phandle = <0x79>;
		phandle = <0x79>;
	};

	firmware {

		android {
			compatible = "android,firmware";

			fstab {
				compatible = "android,fstab";

				system {
					compatible = "android,system";
					dev = "/dev/block/platform/bootdevice/by-name/system";
					type = "ext4";
					mnt_flags = "ro";
					fsmgr_flags = "wait";
				};

				vendor {
					compatible = "android,vendor";
					dev = "/dev/block/platform/bootdevice/by-name/vendor";
					type = "ext4";
					mnt_flags = "ro";
					fsmgr_flags = "wait";
				};
			};
		};
	};

	odm {
		compatible = "simple-bus";
		linux,phandle = <0x7a>;
		phandle = <0x7a>;
	};

	trusty {
		compatible = "android,trusty-smc-v1";
		ranges;
		#address-cells = <0x02>;
		#size-cells = <0x02>;

		irq {
			compatible = "android,trusty-irq-v1";
			ppi-interrupt-parent = <0x02>;
		};

		log {
			compatible = "android,trusty-log-v1";
		};

		virtio {
			compatible = "android,trusty-virtio-v1";
		};

		mtee {
			compatible = "mediatek,trusty-mtee-v1";
		};
	};

	mt_pmic_regulator {
		compatible = "mediatek,mt_pmic";

		buck_regulators {
			compatible = "mediatek,mt_pmic_buck_regulators";

			buck_vs1 {
				regulator-name = "vs1";
				regulator-min-microvolt = <0x124f80>;
				regulator-max-microvolt = <0x2191c0>;
				regulator-ramp-delay = <0x30d4>;
				regulator-enable-ramp-delay = <0xdc>;
				linux,phandle = <0x7b>;
				phandle = <0x7b>;
			};

			buck_vmodem {
				regulator-name = "vmodem";
				regulator-min-microvolt = <0x7a120>;
				regulator-max-microvolt = <0x123716>;
				regulator-ramp-delay = <0x186a>;
				regulator-enable-ramp-delay = <0xdc>;
				linux,phandle = <0x7c>;
				phandle = <0x7c>;
			};

			buck_vcore {
				regulator-name = "vcore";
				regulator-min-microvolt = <0x7ea5e>;
				regulator-max-microvolt = <0x123716>;
				regulator-ramp-delay = <0x186a>;
				regulator-enable-ramp-delay = <0xdc>;
				linux,phandle = <0x7d>;
				phandle = <0x7d>;
			};

			buck_vproc {
				regulator-name = "vproc";
				regulator-min-microvolt = <0x7ea5e>;
				regulator-max-microvolt = <0x1406f4>;
				regulator-ramp-delay = <0x186a>;
				regulator-enable-ramp-delay = <0xdc>;
				linux,phandle = <0x7e>;
				phandle = <0x7e>;
			};

			buck_vpa {
				regulator-name = "vpa";
				regulator-min-microvolt = <0x7a120>;
				regulator-max-microvolt = <0x37b1d0>;
				regulator-ramp-delay = <0xc350>;
				regulator-enable-ramp-delay = <0xdc>;
				linux,phandle = <0x7f>;
				phandle = <0x7f>;
			};
		};

		ldo_regulators {
			compatible = "mediatek,mt_pmic_ldo_regulators";

			ldo_vfe28 {
				compatible = "regulator-fixed";
				regulator-name = "vfe28";
				regulator-min-microvolt = <0x2ab980>;
				regulator-max-microvolt = <0x2ab980>;
				regulator-enable-ramp-delay = <0x108>;
				linux,phandle = <0x80>;
				phandle = <0x80>;
			};

			ldo_vxo22 {
				regulator-name = "vxo22";
				regulator-min-microvolt = <0x2191c0>;
				regulator-max-microvolt = <0x249f00>;
				regulator-enable-ramp-delay = <0x6e>;
				linux,phandle = <0x81>;
				phandle = <0x81>;
			};

			ldo_vrf18 {
				compatible = "regulator-fixed";
				regulator-name = "vrf18";
				regulator-min-microvolt = <0x1b7740>;
				regulator-max-microvolt = <0x1b7740>;
				regulator-enable-ramp-delay = <0x6e>;
				linux,phandle = <0x82>;
				phandle = <0x82>;
			};

			ldo_vrf12 {
				compatible = "regulator-fixed";
				regulator-name = "vrf12";
				regulator-min-microvolt = <0x124f80>;
				regulator-max-microvolt = <0x124f80>;
				regulator-enable-ramp-delay = <0x6e>;
				linux,phandle = <0x83>;
				phandle = <0x83>;
			};

			ldo_vefuse {
				regulator-name = "vefuse";
				regulator-min-microvolt = <0x124f80>;
				regulator-max-microvolt = <0x325aa0>;
				regulator-enable-ramp-delay = <0x108>;
				linux,phandle = <0x84>;
				phandle = <0x84>;
			};

			ldo_vcn33_bt {
				regulator-name = "vcn33_bt";
				regulator-min-microvolt = <0x325aa0>;
				regulator-max-microvolt = <0x3567e0>;
				regulator-enable-ramp-delay = <0x108>;
				linux,phandle = <0x85>;
				phandle = <0x85>;
			};

			ldo_vcn33_wifi {
				regulator-name = "vcn33_wifi";
				regulator-min-microvolt = <0x325aa0>;
				regulator-max-microvolt = <0x3567e0>;
				regulator-enable-ramp-delay = <0x108>;
				linux,phandle = <0x86>;
				phandle = <0x86>;
			};

			ldo_vcn28 {
				compatible = "regulator-fixed";
				regulator-name = "vcn28";
				regulator-min-microvolt = <0x2ab980>;
				regulator-max-microvolt = <0x2ab980>;
				regulator-enable-ramp-delay = <0x108>;
				linux,phandle = <0x87>;
				phandle = <0x87>;
			};

			ldo_vcn18 {
				compatible = "regulator-fixed";
				regulator-name = "vcn18";
				regulator-min-microvolt = <0x1b7740>;
				regulator-max-microvolt = <0x1b7740>;
				regulator-enable-ramp-delay = <0x108>;
				linux,phandle = <0x88>;
				phandle = <0x88>;
			};

			ldo_vcama {
				regulator-name = "vcama";
				regulator-min-microvolt = <0x2625a0>;
				regulator-max-microvolt = <0x2ab980>;
				regulator-enable-ramp-delay = <0x108>;
				linux,phandle = <0x89>;
				phandle = <0x89>;
			};

			ldo_vcamd {
				regulator-name = "vcamd";
				regulator-min-microvolt = <0xf4240>;
				regulator-max-microvolt = <0x1b7740>;
				regulator-enable-ramp-delay = <0x108>;
				linux,phandle = <0x8a>;
				phandle = <0x8a>;
			};

			ldo_vcamio {
				compatible = "regulator-fixed";
				regulator-name = "vcamio";
				regulator-min-microvolt = <0x1b7740>;
				regulator-max-microvolt = <0x1b7740>;
				regulator-enable-ramp-delay = <0x108>;
				linux,phandle = <0x8b>;
				phandle = <0x8b>;
			};

			ldo_vldo28 {
				regulator-name = "vldo28";
				regulator-min-microvolt = <0x2ab980>;
				regulator-max-microvolt = <0x2dc6c0>;
				regulator-enable-ramp-delay = <0x108>;
				linux,phandle = <0x8c>;
				phandle = <0x8c>;
			};

			ldo_vsram_others {
				regulator-name = "vsram_others";
				regulator-min-microvolt = <0x7ea5e>;
				regulator-max-microvolt = <0x1406f4>;
				regulator-ramp-delay = <0x186a>;
				regulator-enable-ramp-delay = <0x6e>;
				linux,phandle = <0x8d>;
				phandle = <0x8d>;
			};

			ldo_vsram_proc {
				regulator-name = "vsram_proc";
				regulator-min-microvolt = <0x7ea5e>;
				regulator-max-microvolt = <0x1406f4>;
				regulator-ramp-delay = <0x186a>;
				regulator-enable-ramp-delay = <0x6e>;
				linux,phandle = <0x8e>;
				phandle = <0x8e>;
			};

			ldo_vaux18 {
				compatible = "regulator-fixed";
				regulator-name = "vaux18";
				regulator-min-microvolt = <0x1b7740>;
				regulator-max-microvolt = <0x1b7740>;
				regulator-enable-ramp-delay = <0x108>;
				linux,phandle = <0x8f>;
				phandle = <0x8f>;
			};

			ldo_vaud28 {
				compatible = "regulator-fixed";
				regulator-name = "vaud28";
				regulator-min-microvolt = <0x2ab980>;
				regulator-max-microvolt = <0x2ab980>;
				regulator-enable-ramp-delay = <0x108>;
				linux,phandle = <0x90>;
				phandle = <0x90>;
			};

			ldo_vio28 {
				compatible = "regulator-fixed";
				regulator-name = "vio28";
				regulator-min-microvolt = <0x2ab980>;
				regulator-max-microvolt = <0x2ab980>;
				regulator-enable-ramp-delay = <0x108>;
				linux,phandle = <0x91>;
				phandle = <0x91>;
			};

			ldo_vio18 {
				compatible = "regulator-fixed";
				regulator-name = "vio18";
				regulator-min-microvolt = <0x1b7740>;
				regulator-max-microvolt = <0x1b7740>;
				regulator-enable-ramp-delay = <0x108>;
				linux,phandle = <0x92>;
				phandle = <0x92>;
			};

			ldo_vdram {
				regulator-name = "vdram";
				regulator-min-microvolt = <0x10c8e0>;
				regulator-max-microvolt = <0x124f80>;
				regulator-enable-ramp-delay = <0xce4>;
				linux,phandle = <0x93>;
				phandle = <0x93>;
			};

			ldo_vmc {
				regulator-name = "vmc";
				regulator-min-microvolt = <0x1b7740>;
				regulator-max-microvolt = <0x325aa0>;
				regulator-enable-ramp-delay = <0x2c>;
				linux,phandle = <0x30>;
				phandle = <0x30>;
			};

			ldo_vmch {
				regulator-name = "vmch";
				regulator-min-microvolt = <0x2c4020>;
				regulator-max-microvolt = <0x325aa0>;
				regulator-enable-ramp-delay = <0x2c>;
				linux,phandle = <0x2f>;
				phandle = <0x2f>;
			};

			ldo_vemc {
				regulator-name = "vemc";
				regulator-min-microvolt = <0x2c4020>;
				regulator-max-microvolt = <0x325aa0>;
				regulator-enable-ramp-delay = <0x2c>;
				linux,phandle = <0x28>;
				phandle = <0x28>;
			};

			ldo_vsim1 {
				regulator-name = "vsim1";
				regulator-min-microvolt = <0x19f0a0>;
				regulator-max-microvolt = <0x2f4d60>;
				regulator-enable-ramp-delay = <0x108>;
				linux,phandle = <0x94>;
				phandle = <0x94>;
			};

			ldo_vsim2 {
				regulator-name = "vsim2";
				regulator-min-microvolt = <0x19f0a0>;
				regulator-max-microvolt = <0x2f4d60>;
				regulator-enable-ramp-delay = <0x108>;
				linux,phandle = <0x95>;
				phandle = <0x95>;
			};

			ldo_vibr {
				regulator-name = "vibr";
				regulator-min-microvolt = <0x124f80>;
				regulator-max-microvolt = <0x325aa0>;
				regulator-enable-ramp-delay = <0x2c>;
				linux,phandle = <0x96>;
				phandle = <0x96>;
			};

			ldo_vusb33 {
				regulator-name = "vusb33";
				regulator-min-microvolt = <0x2dc6c0>;
				regulator-max-microvolt = <0x2f4d60>;
				regulator-enable-ramp-delay = <0x108>;
				linux,phandle = <0x97>;
				phandle = <0x97>;
			};
		};
	};

	__symbols__ {
		chosen = "/chosen";
		cpu0 = "/cpus/cpu@0";
		cpu1 = "/cpus/cpu@001";
		cpu2 = "/cpus/cpu@002";
		cpu3 = "/cpus/cpu@003";
		STANDBY = "/cpus/idle-states/standby";
		MCDI_CPU = "/cpus/idle-states/mcdi-cpu";
		MCDI_CLUSTER = "/cpus/idle-states/mcdi-cluster";
		SODI = "/cpus/idle-states/sodi";
		SODI3 = "/cpus/idle-states/sodi3";
		DPIDLE = "/cpus/idle-states/dpidle";
		SUSPEND = "/cpus/idle-states/suspend";
		cpu_dbgapb = "/cpu_dbgapb";
		reserved_memory = "/reserved-memory";
		gic = "/interrupt-controller@0c000000";
		sysirq = "/intpol-controller@0x10200620";
		clk26m = "/clk26m";
		topckgen = "/topckgen@10000000";
		infracfg_ao = "/infracfg_ao@10001000";
		scpsys = "/scpsys@10001000";
		clk32k = "/clk32k";
		syscfg_pctl_lt = "/syscfg_pctl_lt@10002000";
		syscfg_pctl_lm = "/syscfg_pctl_lm@10002200";
		syscfg_pctl_lb = "/syscfg_pctl_lb@10002400";
		syscfg_pctl_bl = "/syscfg_pctl_bl@10002600";
		syscfg_pctl_bm = "/syscfg_pctl_bm@10002800";
		syscfg_pctl_rb = "/syscfg_pctl_rb@10002a00";
		syscfg_pctl_rt = "/syscfg_pctl_bl@10002c00";
		gpio_usage_mapping = "/gpio";
		gpio = "/gpio@10005000";
		syscfg_pctl_a = "/syscfg_pctl_a@10005000";
		accdet = "/accdet";
		pio = "/pinctrl@1000b000";
		apmixed = "/apmixed@1000c000";
		main_pmic = "/pwrap@1000d000/pmic_irq";
		keypad = "/kp@10010000";
		mdcldma = "/mdcldma@10014000";
		auxadc = "/auxadc@11001000";
		apuart0 = "/apuart0@11002000";
		apuart1 = "/apuart1@11003000";
		i2c0 = "/i2c@11007000";
		i2c1 = "/i2c@11008000";
		i2c2 = "/i2c@11009000";
		i2c3 = "/i2c@1100f000";
		i2c4 = "/i2c@11011000";
		i2c5 = "/i2c@11016000";
		spi0 = "/spi@1100a000";
		spi1 = "/spi@11010000";
		spi2 = "/spi@11012000";
		msdc0 = "/msdc@11230000";
		msdc0_pins_default = "/msdc@11230000/msdc0@default";
		msdc0_register_setting_default = "/msdc@11230000/msdc0@register_default";
		msdc1 = "/msdc@11240000";
		msdc1_pins_default = "/msdc@11240000/msdc1@default";
		msdc1_pins_sdr104 = "/msdc@11240000/msdc1@sdr104";
		msdc1_pins_sdr50 = "/msdc@11240000/msdc1@sdr50";
		msdc1_pins_ddr50 = "/msdc@11240000/msdc1@ddr50";
		msdc1_register_setting_default = "/msdc@11240000/msdc1@register_default";
		audio = "/audio@11220000";
		audgpio = "/mt_soc_dl1_pcm@11220000";
		mmsys_config = "/mmsys_config@14000000";
		touch = "/touch";
		flashlight_core = "/flashlight_core";
		flashlights_rt4505 = "/flashlights_rt4505";
		flashlights_gpio = "/flashlights_dummy_gpio";
		sub_flashlights_dummy_gpio = "/sub_flashlights_dummy_gpio";
		mtkfb = "/mtkfb";
		disp_mutex = "/disp_mutex@14001000";
		lcm_mode = "/lcm_mode";
		smi_larb0 = "/smi_larb0@14003000";
		mdp_rdma0 = "/mdp_rdma0@14004000";
		mdp_rsz0 = "/mdp_rsz0@14005000";
		mdp_rsz1 = "/mdp_rsz1@14006000";
		mdp_wdma0 = "/mdp_wdma0@14007000";
		mdp_wrot0 = "/mdp_wrot0@14008000";
		mdp_tdshp0 = "/mdp_tdshp0@14009000";
		disp_ovl0 = "/disp_ovl0@1400a000";
		disp_aal0 = "/disp_aal0@1400f000";
		dispsys = "/dispsys@14000000";
		mm_mutex = "/mm_mutex@14016000";
		imgsys_config = "/imgsys_config@15000000";
		smi_larb2 = "/smi_larb2@15001000";
		venc_global_con = "/venc_global_con@17000000";
		venc = "/venc@17020000";
		smi_larb1 = "/smi_larb1@17010000";
		bat_gm30 = "/bat_gm30";
		mt_charger = "/mt_charger";
		charger = "/charger";
		pmic_clock_buffer_ctrl = "/pmic_clock_buffer_ctrl";
		consys = "/consys@18070000";
		goodix_fp = "/goodix_fp";
		hct_finger = "/hct_finger";
		fpc_finger = "/fpc_finger";
		sunwave_fp = "/sunwave_fp";
		fingerprint = "/fingerprint";
		fpsensor_finger = "/fpsensor_finger";
		ptt_key = "/ptt_key";
		soc_key = "/soc_key";
		mdr_drv = "/mdr_drv";
		halldriver = "/hall_driver";
		hall = "/halleint";
		als = "/als_ps@0";
		gse_1 = "/gse_1";
		mse = "/mse";
		gyro = "/gyro";
		smart_pa = "/smart_pa";
		mrdump_ext_rst = "/mrdump_ext_rst";
		msdc1_ins = "/msdc1_ins";
		chr_stat = "/chr_stat";
		rt9465_slave_chr = "/rt9465_slave_chr";
		dsi_te = "/dsi_te";
		kd_camera_hw1 = "/kd_camera_hw1@15008000";
		otg_iddig = "/otg_iddig";
		nfc = "/nfc";
		irq_nfc = "/irq_nfc";
		md1_sim1_hot_plug_eint = "/md1_sim1_hot_plug_eint";
		md1_sim2_hot_plug_eint = "/md1_sim2_hot_plug_eint";
		irtx_pwm = "/irtx_pwm";
		odm = "/odm";
		mt_pmic_vs1_buck_reg = "/mt_pmic_regulator/buck_regulators/buck_vs1";
		mt_pmic_vmodem_buck_reg = "/mt_pmic_regulator/buck_regulators/buck_vmodem";
		mt_pmic_vcore_buck_reg = "/mt_pmic_regulator/buck_regulators/buck_vcore";
		mt_pmic_vproc_buck_reg = "/mt_pmic_regulator/buck_regulators/buck_vproc";
		mt_pmic_vpa_buck_reg = "/mt_pmic_regulator/buck_regulators/buck_vpa";
		mt_pmic_vfe28_ldo_reg = "/mt_pmic_regulator/ldo_regulators/ldo_vfe28";
		mt_pmic_vxo22_ldo_reg = "/mt_pmic_regulator/ldo_regulators/ldo_vxo22";
		mt_pmic_vrf18_ldo_reg = "/mt_pmic_regulator/ldo_regulators/ldo_vrf18";
		mt_pmic_vrf12_ldo_reg = "/mt_pmic_regulator/ldo_regulators/ldo_vrf12";
		mt_pmic_vefuse_ldo_reg = "/mt_pmic_regulator/ldo_regulators/ldo_vefuse";
		mt_pmic_vcn33_bt_ldo_reg = "/mt_pmic_regulator/ldo_regulators/ldo_vcn33_bt";
		mt_pmic_vcn33_wifi_ldo_reg = "/mt_pmic_regulator/ldo_regulators/ldo_vcn33_wifi";
		mt_pmic_vcn28_ldo_reg = "/mt_pmic_regulator/ldo_regulators/ldo_vcn28";
		mt_pmic_vcn18_ldo_reg = "/mt_pmic_regulator/ldo_regulators/ldo_vcn18";
		mt_pmic_vcama_ldo_reg = "/mt_pmic_regulator/ldo_regulators/ldo_vcama";
		mt_pmic_vcamd_ldo_reg = "/mt_pmic_regulator/ldo_regulators/ldo_vcamd";
		mt_pmic_vcamio_ldo_reg = "/mt_pmic_regulator/ldo_regulators/ldo_vcamio";
		mt_pmic_vldo28_ldo_reg = "/mt_pmic_regulator/ldo_regulators/ldo_vldo28";
		mt_pmic_vsram_others_ldo_reg = "/mt_pmic_regulator/ldo_regulators/ldo_vsram_others";
		mt_pmic_vsram_proc_ldo_reg = "/mt_pmic_regulator/ldo_regulators/ldo_vsram_proc";
		mt_pmic_vaux18_ldo_reg = "/mt_pmic_regulator/ldo_regulators/ldo_vaux18";
		mt_pmic_vaud28_ldo_reg = "/mt_pmic_regulator/ldo_regulators/ldo_vaud28";
		mt_pmic_vio28_ldo_reg = "/mt_pmic_regulator/ldo_regulators/ldo_vio28";
		mt_pmic_vio18_ldo_reg = "/mt_pmic_regulator/ldo_regulators/ldo_vio18";
		mt_pmic_vdram_ldo_reg = "/mt_pmic_regulator/ldo_regulators/ldo_vdram";
		mt_pmic_vmc_ldo_reg = "/mt_pmic_regulator/ldo_regulators/ldo_vmc";
		mt_pmic_vmch_ldo_reg = "/mt_pmic_regulator/ldo_regulators/ldo_vmch";
		mt_pmic_vemc_ldo_reg = "/mt_pmic_regulator/ldo_regulators/ldo_vemc";
		mt_pmic_vsim1_ldo_reg = "/mt_pmic_regulator/ldo_regulators/ldo_vsim1";
		mt_pmic_vsim2_ldo_reg = "/mt_pmic_regulator/ldo_regulators/ldo_vsim2";
		mt_pmic_vibr_ldo_reg = "/mt_pmic_regulator/ldo_regulators/ldo_vibr";
		mt_pmic_vusb33_ldo_reg = "/mt_pmic_regulator/ldo_regulators/ldo_vusb33";
	};
};
